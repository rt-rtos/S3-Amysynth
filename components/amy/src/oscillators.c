#include "amy.h"


// For checking assumptions about bitwidths.
#include <assert.h>

#include "sine_lutset_fxpt.h"
#include "saw_lutset_fxpt.h"
#include "triangle_lutset_fxpt.h"

// For hardware random on ESP
#ifdef ESP_PLATFORM
#include <esp_system.h>
#endif

// Multiply used to apply amplitude to unit waveforms. sample is first arg (<=1), amp is 2nd.
//#define MULA_SS MUL6A_SS
#define MULA_SS(a, b) MUL5A_SS(a, b)


/* Dan Ellis libblosca functions */
const LUT *choose_from_lutset(float period, const LUT *lutset) {
    // Select the best entry from a lutset for a given period. 
    //
    // Args:
    //    period: (float) Target period of waveform in fractional samples.
    //    lutset: Sorted list of LUTs, as generated by create_lutset().
    //
    // Returns:
    //   One of the LUTs from the lutset, best suited to interpolating to generate
    //   a waveform of the desired period.
    // Use the earliest (i.e., longest, most harmonics) LUT that works
    // (i.e., will not actually cause aliasing).
    // So start with the highest-bandwidth (and longest) LUTs, but skip them
    // if they result in aliasing.
    const LUT *lut_table = NULL;
    int lut_size = 0;
    int lut_index = 0;
    while(lutset[lut_index].table_size > 0) {
        lut_table = &lutset[lut_index];
        lut_size = lutset[lut_index].table_size;
        // What proportion of nyquist does the highest harmonic in this table occupy?
        float lut_bandwidth = 2 * lutset[lut_index].highest_harmonic / (float)lut_size;
        // To complete one cycle of <lut_size> points in <period> steps, each step
        // will need to be this many samples:
        float lut_hop = lut_size / period;
        // If we have a signal with a given bandwidth, but then speed it up by 
        // skipping lut_hop samples per sample, its bandwidth will increase 
        // proportionately.
        float interp_bandwidth = lut_bandwidth * lut_hop;
        //printf("period=%f freq=%f lut_size=%d interp_bandwidth=%f\n", period, ((float)AMY_SAMPLE_RATE)/period, lut_size, interp_bandwidth);
        if (interp_bandwidth < 0.9f) {
            // No aliasing, even with a 10% buffer (i.e., 19.8 kHz).
            break;
        }
        ++lut_index;
    }
    // At this point, we either got to the end of the LUT table, or we found a
    // table we could interpolate without aliasing.

    return lut_table;
}

// Multiple versions of render_lut with different features to avoid branches in sample loop.

#define RENDER_LUT_PREAMBLE \
    if(lut == NULL)  return phase;\
    int lut_mask = lut->table_size - 1; \
    int lut_bits = lut->log_2_table_size; \
    SAMPLE sample = 0; \
    SAMPLE max_value = 0; \
    SAMPLE current_amp = incoming_amp;                                      \
    SAMPLE incremental_amp = SHIFTR(ending_amp - incoming_amp, BLOCK_SIZE_BITS);

#define MOD_PART_MOD  \
            total_phase += S2P(mod[i]);

// Feedback is taken before output scaling.
#define FEEDBACK_PART_FB  \
            past1 = past0;  \
            past0 = sample;  \
            total_phase += S2P(MUL4_SS(feedback_level, SHIFTR(past1 + past0, 1)));

#define RENDER_LUT_GUTS(MOD_PART, FEEDBACK_PART, INTERP_PART) \
            MOD_PART \
            FEEDBACK_PART \
            int16_t base_index = INT_OF_P(total_phase, lut_bits); \
            SAMPLE frac = S_FRAC_OF_P(total_phase, lut_bits); \
            SAMPLE b = L2S(lut->table[base_index]); \
            SAMPLE c = L2S(lut->table[(base_index + 1) & lut_mask]); \
            INTERP_PART

#define INTERP_LINEAR \
            sample = b + MUL0_SS(c - b, frac);

// Miller's optimization -
// https://github.com/pure-data/pure-data/blob/db777311d808bb3ba728b94ab067f8d333b7d0c2/src/d_array.c#L831C1-L833C76
// outlet_float(x->x_obj.ob_outlet, b + frac * (
//    cminusb - 0.1666667f * (1.-frac) * (
//        (d - a - 3.0f * cminusb) * frac + (d + 2.0f*a - 3.0f*b))));#
#define INTERP_CUBIC \
            SAMPLE a = L2S(lut->table[(base_index - 1) & lut_mask]); \
            SAMPLE d = L2S(lut->table[(base_index + 2) & lut_mask]); \
            SAMPLE cminusb = c - b; \
            SAMPLE fr_d_ma_m3cmb = MUL0_SS(d - a - cminusb - SHIFTL(cminusb, 1), frac); \
            SAMPLE next_bit = MUL0_SS(fr_d_ma_m3cmb + d + SHIFTL(a - b, 1) - b, MUL0_SS(F2S(1.0f) - frac, F2S(0.16666666666667f))); \
            sample = b + MUL0_SS(cminusb - next_bit, frac);

#define RENDER_LUT_LOOP_END \
            SAMPLE value = buf[i] + MULA_SS(sample, current_amp);	\
            buf[i] = value;                            \
            if (value < 0) value = -value;             \
            if (value > max_value) max_value = value;  \
            current_amp += incremental_amp; \
            phase = P_WRAPPED_SUM(phase, step);


#define NOTHING ;

/* is this in fact ever used? */
// LOCAL EDIT (S3-Amysynth): render-path kernel, keep in IRAM (upstream leaves unannotated)
AMY_IRAM_ATTR PHASOR render_lut_fm_fb(SAMPLE* buf,
                        PHASOR phase, 
                        PHASOR step,
                        SAMPLE incoming_amp, SAMPLE ending_amp,
                        const LUT* lut,
                        SAMPLE* mod, SAMPLE feedback_level, SAMPLE* last_two, SAMPLE *pmax_value) { 
    AMY_PROFILE_START(RENDER_LUT_FM_FB)
    RENDER_LUT_PREAMBLE
    SAMPLE past0 = 0, past1 = 0;
    sample = last_two[0];
    past0 = last_two[1];
    for(uint16_t i = 0; i < AMY_BLOCK_SIZE; i++) {
        PHASOR total_phase = phase;

        RENDER_LUT_GUTS(MOD_PART_MOD, FEEDBACK_PART_FB, INTERP_LINEAR)

        RENDER_LUT_LOOP_END
    }
    last_two[0] = sample;
    last_two[1] = past0;
    *pmax_value = max_value;
    AMY_PROFILE_STOP(RENDER_LUT_FM_FB)
    return phase;
}

AMY_IRAM_ATTR PHASOR render_lut_fb(SAMPLE* buf,
                     PHASOR phase,
                     PHASOR step,
                     SAMPLE incoming_amp, SAMPLE ending_amp,
                     const LUT* lut,
                     SAMPLE feedback_level, SAMPLE* last_two, SAMPLE *pmax_value) {
    AMY_PROFILE_START(RENDER_LUT_FB)
    RENDER_LUT_PREAMBLE
    SAMPLE past0 = 0, past1 = 0;
    sample = last_two[0];
    past0 = last_two[1];
    for(uint16_t i = 0; i < AMY_BLOCK_SIZE; i++) {
        PHASOR total_phase = phase;

        RENDER_LUT_GUTS(NOTHING, FEEDBACK_PART_FB, INTERP_LINEAR)

        RENDER_LUT_LOOP_END
    }
    last_two[0] = sample;
    last_two[1] = past0;
    *pmax_value = max_value;
    AMY_PROFILE_STOP(RENDER_LUT_FB)
    return phase;
}

// LOCAL EDIT (S3-Amysynth, upstream PR candidate): render_lut with the mod
// input for the 256-entry sine table the FM operators always read; shifts
// and mask are immediates, so the loop fits the Xtensa register window as
// a hardware loop (32 insns, no spills; the generic body is a 65-insn plain
// loop). Same expressions as RENDER_LUT_GUTS(MOD_PART_MOD, NOTHING,
// INTERP_LINEAR) with lut_bits = 8.
static __attribute__((noinline)) AMY_IRAM_ATTR PHASOR render_lut_fm_256(SAMPLE* buf,
                     PHASOR phase,
                     PHASOR step,
                     SAMPLE incoming_amp, SAMPLE ending_amp,
                     const LUTSAMPLE* table,
                     SAMPLE* mod,
                     SAMPLE* pmax_value) {
    SAMPLE sample = 0;
    SAMPLE max_value = 0;
    SAMPLE current_amp = incoming_amp;
    SAMPLE incremental_amp = SHIFTR(ending_amp - incoming_amp, BLOCK_SIZE_BITS);
    for(uint16_t i = 0; i < AMY_BLOCK_SIZE; i++) {
        PHASOR total_phase = phase;
        total_phase += S2P(mod[i]);
        int16_t base_index = INT_OF_P(total_phase, 8);
        SAMPLE frac = S_FRAC_OF_P(total_phase, 8);
        SAMPLE b = L2S(table[base_index]);
        SAMPLE c = L2S(table[(base_index + 1) & 255]);
        sample = b + MUL0_SS(c - b, frac);
        RENDER_LUT_LOOP_END
    }
    *pmax_value = max_value;
    return phase;
}

AMY_IRAM_ATTR PHASOR render_lut_fm(SAMPLE* buf,
                     PHASOR phase,
                     PHASOR step,
                     SAMPLE incoming_amp, SAMPLE ending_amp,
                     const LUT* lut,
                     SAMPLE* mod,
                     SAMPLE* pmax_value) {
    AMY_PROFILE_START(RENDER_LUT_FM)
    if (lut != NULL && lut->log_2_table_size == 8) {
        phase = render_lut_fm_256(buf, phase, step, incoming_amp, ending_amp, lut->table, mod, pmax_value);
        AMY_PROFILE_STOP(RENDER_LUT_FM)
        return phase;
    }
    RENDER_LUT_PREAMBLE
    for(uint16_t i = 0; i < AMY_BLOCK_SIZE; i++) {
        PHASOR total_phase = phase;

        RENDER_LUT_GUTS(MOD_PART_MOD, NOTHING, INTERP_LINEAR)

        RENDER_LUT_LOOP_END
    }
    *pmax_value = max_value;
    AMY_PROFILE_STOP(RENDER_LUT_FM)
    return phase;
}

AMY_IRAM_ATTR PHASOR render_lut(SAMPLE* buf,
                  PHASOR phase,
                  PHASOR step,
                  SAMPLE incoming_amp, SAMPLE ending_amp,
                  const LUT* lut,
                  SAMPLE* pmax_value) {
    AMY_PROFILE_START(RENDER_LUT)
    RENDER_LUT_PREAMBLE
    for(uint16_t i = 0; i < AMY_BLOCK_SIZE; i++) {
        PHASOR total_phase = phase;

        RENDER_LUT_GUTS(NOTHING, NOTHING, INTERP_LINEAR)

        RENDER_LUT_LOOP_END
     }
    *pmax_value = max_value;
    AMY_PROFILE_STOP(RENDER_LUT)
    return phase;
}

// Highly optimized for 256 pt sine table
AMY_IRAM_ATTR PHASOR render_lut_256(SAMPLE* buf,
                  PHASOR phase,
                  PHASOR step,
                  SAMPLE incoming_amp, SAMPLE ending_amp,
                  const LUT* lut,
                  SAMPLE* pmax_value) {
    // RENDER_LUT_PREAMBLE
    //int lut_mask = 255;
    //int lut_bits = 8;
    SAMPLE sample = 0;
    SAMPLE max_value = 0;
    SAMPLE current_amp = incoming_amp;
    SAMPLE incremental_amp = SHIFTR(ending_amp - incoming_amp, BLOCK_SIZE_BITS);
    phase = SHIFTL(phase, 1);  // Make phase into _32 instead of s_31
    step = SHIFTL(step, 1);
    for(uint16_t i = 0; i < AMY_BLOCK_SIZE; i++) {
        //int16_t base_index = INT_OF_P(phase, lut_bits);
        //int16_t base_index = (int32_t)((((uint32_t)(phase << 1)) >> (P_FRAC_BITS + 1 - lut_bits)));
        int16_t base_index = (int32_t)((((uint32_t)phase) >> 24));
        //SAMPLE frac = S_FRAC_OF_P(phase, lut_bits);
        SAMPLE frac = (int32_t)(((uint32_t)(phase << 8)) >> 9);
        SAMPLE b = L2S(lut->table[base_index]);
        //SAMPLE c = L2S(lut->table[(base_index + 1) & lut_mask]);
        SAMPLE c = L2S(lut->table[base_index + 1]); // table has guard point at end
        sample = b + MUL0_SS(c - b, frac);
        SAMPLE value = buf[i] + MULA_SS(sample, current_amp);
        buf[i] = value;
        if (value < 0) value = -value;
        if (value > max_value) max_value = value;
        current_amp += incremental_amp;
        //phase = P_WRAPPED_SUM(phase, step);
        phase = (int32_t)((uint32_t)(((uint32_t)phase) + ((uint32_t)step)));
    }
    phase = SHIFTR(phase, 1);  // Restore phase to s_31
    *pmax_value = max_value;
    return phase;
}

AMY_IRAM_ATTR PHASOR render_lut_cub(SAMPLE* buf,
                      PHASOR phase,
                      PHASOR step,
                      SAMPLE incoming_amp, SAMPLE ending_amp,
                      const LUT* lut,
                      SAMPLE *pmax_value) {
    AMY_PROFILE_START(RENDER_LUT_CUB)
    RENDER_LUT_PREAMBLE
    for(uint16_t i = 0; i < AMY_BLOCK_SIZE; i++) {
        PHASOR total_phase = phase;

        RENDER_LUT_GUTS(NOTHING, NOTHING, INTERP_CUBIC)

        RENDER_LUT_LOOP_END
    }
    *pmax_value = max_value;
    AMY_PROFILE_STOP(RENDER_LUT_CUB)
    return phase;
}

/* LOCAL EDIT (S3-Amysynth, experimental): unison cluster.
 * One osc renders unison_count detuned copies of its LUT wave into its own
 * buffer, so the envelope, filter, dist, pan and every mod rail stay one per
 * osc.  Copy i sits at logfreq + unison_offset + i * unison_spacing
 * (octaves); logfreq is the per-block value from hold_and_modify, so NOTE,
 * BEND, portamento and the pitch rails move the whole cluster.  Weights
 * taper the outer copies by their position in the cluster's own span
 * (unison_blend 1 = equal) and are power-normalized, so the cluster's level
 * tracks a single copy.  Copy 0 rides synth->phase, the rest
 * synth->unison_phase[].  Waves that do not go through a LUT renderer
 * (PCM, KS, ALGO, partials, noise) ignore the count. */
typedef struct {
    PHASOR step;
    SAMPLE last_amp;
    SAMPLE amp;
} unison_copy;

static inline PHASOR *unison_phase(uint16_t osc, uint8_t i) {
    return i ? &synth[osc]->unison_phase[i - 1] : &synth[osc]->phase;
}

// Respread copies 1..n-1 evenly from copy 0's phase: deterministic and
// decorrelated, whatever phase copy 0 restarts with.
void unison_note_on(uint16_t osc) {
    uint8_t n = synth[osc]->unison_count;
    for (uint8_t i = 1; i < n; ++i)
        synth[osc]->unison_phase[i - 1] = P_WRAPPED_SUM(synth[osc]->phase, F2P((float)i / (float)n));
}

// Terms that depend only on the cluster parameters: the copy ratios
// 2^(offset + i * spacing) and the power-normalized weights.  Every osc
// with the same (count, spacing, offset, blend) shares one entry, refilled
// only when a parameter changes.  One entry suffices because the render
// path is single-threaded here (multicore=0); a multicore build would need
// one per core.
typedef struct {
    uint8_t count;   // 0: empty
    float spacing;
    float offset;
    float blend;
    float ratio[AMY_UNISON_MAX];
    SAMPLE gain[AMY_UNISON_MAX];
} unison_terms;

static unison_terms unison_cache;

static void unison_terms_fill(unison_terms *t, uint8_t n, float spacing, float offset, float blend) {
    float span = fabsf(offset);
    float last = fabsf(offset + (float)(n - 1) * spacing);
    if (last > span) span = last;
    // Position of a copy in -1..1 is its offset over the span; a cluster
    // with no detune has no positions, so every weight is 1.
    float taper = (span > 0) ? (1.0f - blend) / span : 0;
    float w[AMY_UNISON_MAX];
    float sum = 0;
    for (uint8_t i = 0; i < n; ++i) {
        float d = offset + (float)i * spacing;
        w[i] = 1.0f - taper * fabsf(d);
        sum += w[i] * w[i];
        t->ratio[i] = exp2f(d);
    }
    // Blend 0 on a cluster with no center copy zeroes every weight; fall
    // back to equal weights rather than dividing by zero.
    float norm = 1.0f / sqrtf((float)n);
    if (sum > 1e-6f) norm = 1.0f / sqrtf(sum);
    else for (uint8_t i = 0; i < n; ++i) w[i] = 1.0f;
    for (uint8_t i = 0; i < n; ++i) t->gain[i] = F2S(w[i] * norm);
    t->count = n;
    t->spacing = spacing;
    t->offset = offset;
    t->blend = blend;
}

// Per-block copy table: step and amp pair per copy.  n = 1 is exactly the
// single step/amp pair the renderers used before; the cluster path scales
// the caller's freq by each copy's ratio.
static uint8_t unison_prepare(uint16_t osc, unison_copy *c, float freq, SAMPLE last_amp, SAMPLE amp) {
    uint8_t n = synth[osc]->unison_count;
    float base_step = freq * (1.0f / (float)AMY_SAMPLE_RATE);
    if (n <= 1) {
        c[0].step = F2P(base_step);
        c[0].last_amp = last_amp;
        c[0].amp = amp;
        return 1;
    }
    unison_terms *t = &unison_cache;
    if (n != t->count || synth[osc]->unison_spacing != t->spacing ||
        synth[osc]->unison_offset != t->offset || synth[osc]->unison_blend != t->blend)
        unison_terms_fill(t, n, synth[osc]->unison_spacing, synth[osc]->unison_offset, synth[osc]->unison_blend);
    for (uint8_t i = 0; i < n; ++i) {
        c[i].step = F2P(base_step * t->ratio[i]);
        c[i].last_amp = SMULR7(last_amp, t->gain[i]);
        c[i].amp = SMULR7(amp, t->gain[i]);
    }
    return n;
}

/* Audio in */

void audio_in_note_on(uint16_t osc, uint8_t channel) {
    // do i need to do anything here? probably not
}

void external_audio_in_note_on(uint16_t osc, uint8_t channel) {
    // do i need to do anything here? probably not
}

SAMPLE render_audio_in(SAMPLE * buf, uint16_t osc, uint8_t channel) {
    uint16_t c = 0;
    for(uint16_t i=channel;i<AMY_BLOCK_SIZE*AMY_NCHANS;i=i+(AMY_NCHANS)) {
        buf[c++] = SMULR7(L2S(amy_in_block[i]), F2S(msynth[osc]->amp));
    }
    // We have to return something for max_value or else the zero-amp reaper will come along. 
    return F2S(1.0); //max_value;
}

SAMPLE render_external_audio_in(SAMPLE *buf, uint16_t osc, uint8_t channel) {
    uint16_t c = 0;
    for(uint16_t i=channel;i<AMY_BLOCK_SIZE*AMY_NCHANS;i=i+(AMY_NCHANS)) {
        buf[c++] = SMULR7(L2S(amy_external_in_block[i]), F2S(msynth[osc]->amp));
    }
    // We have to return something for max_value or else the zero-amp reaper will come along. 
    return F2S(1.0); //max_value;
}


/* Pulse wave */
void pulse_note_on(uint16_t osc, float freq) {
    // Moved to lazy.
    synth[osc]->lut = NULL;
}

void _pulse_note_on(uint16_t osc) {
    //printf("pulse_note_on: time %lld osc %d logfreq %f amp %f last_amp %f\n", amy_global.total_blocks*AMY_BLOCK_SIZE, osc, synth[osc]->logfreq, msynth[osc]->amp, msynth[osc]->last_amp);
    if (synth[osc]->lut == NULL) {
        float freq = freq_of_logfreq(msynth[osc]->logfreq);
        float period_samples = (float)AMY_SAMPLE_RATE / freq;
        synth[osc]->lut = choose_from_lutset(period_samples, saw_fxpt_lutset);
    }
}

// LOCAL EDIT (S3-Amysynth): size-specialised cubic kernels. render_lut_cub
// is generic over the table size, so its shift amounts and mask live in
// registers; with the two SAR values, the counter, step and the amp
// increment spilled, gcc demotes the loop to decrement-and-branch (74
// insns per sample, 5 stack reloads). With the size a compile-time
// constant the shifts and mask are immediates and the same arithmetic
// compiles to a 63-insn hardware loop, output byte-identical. One
// instantiation per saw table melodic notes reach (2048..64 entries,
// fundamentals to ~4 kHz); smaller tables fall back to the generic kernel.
#define RENDER_LUT_CUB_SIZED(NAME, BITS) \
static __attribute__((noinline)) AMY_IRAM_ATTR PHASOR NAME(SAMPLE* buf, PHASOR phase, PHASOR step, \
                                 SAMPLE incoming_amp, SAMPLE ending_amp, \
                                 const LUTSAMPLE* table, SAMPLE* pmax_value) { \
    SAMPLE max_value = 0; \
    SAMPLE current_amp = incoming_amp; \
    SAMPLE incremental_amp = SHIFTR(ending_amp - incoming_amp, BLOCK_SIZE_BITS); \
    int lut_mask = (1 << (BITS)) - 1; \
    for (uint16_t i = 0; i < AMY_BLOCK_SIZE; i++) { \
        int base_index = INT_OF_P(phase, BITS); \
        SAMPLE frac = S_FRAC_OF_P(phase, BITS); \
        /* INTERP_CUBIC on the raw 16-bit taps: each MUL0_SS(L2S(x), f) is written */ \
        /* as SHIFTR(x * SHIFTR(f, 7), 8), the same value with the L2S shift folded. */ \
        int32_t a = table[(base_index - 1) & lut_mask]; \
        int32_t b = table[base_index]; \
        int32_t c = table[(base_index + 1) & lut_mask]; \
        int32_t d = table[(base_index + 2) & lut_mask]; \
        int32_t cminusb = c - b; \
        SAMPLE frac7 = SHIFTR(frac, 7); \
        SAMPLE fr_d_ma_m3cmb = SHIFTR((d - a - cminusb - SHIFTL(cminusb, 1)) * frac7, 8); \
        SAMPLE next_bit = SHIFTR((SHIFTR(fr_d_ma_m3cmb, 8) + d + SHIFTL(a - b, 1) - b) * SHIFTR(MUL0_SS(F2S(1.0f) - frac, F2S(0.16666666666667f)), 7), 8); \
        SAMPLE sample = L2S(b) + SHIFTR((cminusb + SHIFTR(-next_bit, 8)) * frac7, 8); \
        SAMPLE value = buf[i] + MULA_SS(sample, current_amp); \
        buf[i] = value; \
        if (value < 0) value = -value; \
        if (value > max_value) max_value = value; \
        current_amp += incremental_amp; \
        phase = P_WRAPPED_SUM(phase, step); \
    } \
    *pmax_value = max_value; \
    return phase; \
}
RENDER_LUT_CUB_SIZED(render_lut_cub_11, 11)
RENDER_LUT_CUB_SIZED(render_lut_cub_10, 10)
RENDER_LUT_CUB_SIZED(render_lut_cub_9, 9)
RENDER_LUT_CUB_SIZED(render_lut_cub_8, 8)
RENDER_LUT_CUB_SIZED(render_lut_cub_7, 7)
RENDER_LUT_CUB_SIZED(render_lut_cub_6, 6)

static AMY_IRAM_ATTR PHASOR render_lut_cub_sized(SAMPLE* buf, PHASOR phase, PHASOR step,
        SAMPLE incoming_amp, SAMPLE ending_amp, const LUT* lut, SAMPLE* pmax_value) {
    if (lut == NULL) return phase;
    switch (lut->log_2_table_size) {
    case 11: return render_lut_cub_11(buf, phase, step, incoming_amp, ending_amp, lut->table, pmax_value);
    case 10: return render_lut_cub_10(buf, phase, step, incoming_amp, ending_amp, lut->table, pmax_value);
    case 9:  return render_lut_cub_9(buf, phase, step, incoming_amp, ending_amp, lut->table, pmax_value);
    case 8:  return render_lut_cub_8(buf, phase, step, incoming_amp, ending_amp, lut->table, pmax_value);
    case 7:  return render_lut_cub_7(buf, phase, step, incoming_amp, ending_amp, lut->table, pmax_value);
    case 6:  return render_lut_cub_6(buf, phase, step, incoming_amp, ending_amp, lut->table, pmax_value);
    default: return render_lut_cub(buf, phase, step, incoming_amp, ending_amp, lut, pmax_value);
    }
}


// LOCAL EDIT (S3-Amysynth): the same size specialisation for the linear
// kernel the detuned unison copies render through (render_lut, 32-insn
// hardware loop generic); INTERP_LINEAR at the 16-bit table scale.
#define RENDER_LUT_LIN_SIZED(NAME, BITS) \
static __attribute__((noinline)) AMY_IRAM_ATTR PHASOR NAME(SAMPLE* buf, PHASOR phase, PHASOR step, \
                                 SAMPLE incoming_amp, SAMPLE ending_amp, \
                                 const LUTSAMPLE* table, SAMPLE* pmax_value) { \
    SAMPLE max_value = 0; \
    SAMPLE current_amp = incoming_amp; \
    SAMPLE incremental_amp = SHIFTR(ending_amp - incoming_amp, BLOCK_SIZE_BITS); \
    for (uint16_t i = 0; i < AMY_BLOCK_SIZE; i++) { \
        int base_index = INT_OF_P(phase, BITS); \
        SAMPLE frac = S_FRAC_OF_P(phase, BITS); \
        int32_t b = table[base_index]; \
        int32_t c = table[(base_index + 1) & ((1 << (BITS)) - 1)]; \
        SAMPLE sample = L2S(b) + SHIFTR((c - b) * SHIFTR(frac, 7), 8); \
        SAMPLE value = buf[i] + MULA_SS(sample, current_amp); \
        buf[i] = value; \
        if (value < 0) value = -value; \
        if (value > max_value) max_value = value; \
        current_amp += incremental_amp; \
        phase = P_WRAPPED_SUM(phase, step); \
    } \
    *pmax_value = max_value; \
    return phase; \
}
RENDER_LUT_LIN_SIZED(render_lut_11, 11)
RENDER_LUT_LIN_SIZED(render_lut_10, 10)
RENDER_LUT_LIN_SIZED(render_lut_9, 9)
RENDER_LUT_LIN_SIZED(render_lut_8, 8)
RENDER_LUT_LIN_SIZED(render_lut_7, 7)
RENDER_LUT_LIN_SIZED(render_lut_6, 6)

static AMY_IRAM_ATTR PHASOR render_lut_sized(SAMPLE* buf, PHASOR phase, PHASOR step,
        SAMPLE incoming_amp, SAMPLE ending_amp, const LUT* lut, SAMPLE* pmax_value) {
    if (lut == NULL) return phase;
    switch (lut->log_2_table_size) {
    case 11: return render_lut_11(buf, phase, step, incoming_amp, ending_amp, lut->table, pmax_value);
    case 10: return render_lut_10(buf, phase, step, incoming_amp, ending_amp, lut->table, pmax_value);
    case 9:  return render_lut_9(buf, phase, step, incoming_amp, ending_amp, lut->table, pmax_value);
    case 8:  return render_lut_8(buf, phase, step, incoming_amp, ending_amp, lut->table, pmax_value);
    case 7:  return render_lut_7(buf, phase, step, incoming_amp, ending_amp, lut->table, pmax_value);
    case 6:  return render_lut_6(buf, phase, step, incoming_amp, ending_amp, lut->table, pmax_value);
    default: return render_lut(buf, phase, step, incoming_amp, ending_amp, lut, pmax_value);
    }
}

AMY_IRAM_ATTR SAMPLE render_lpf_lut(SAMPLE* buf, uint16_t osc, int8_t is_square, int8_t direction, SAMPLE dc_offset) {
    AMY_PROFILE_START(RENDER_LPF_LUT)
    // Common function for pulse and saw.
    float freq = freq_of_logfreq(msynth[osc]->logfreq);
    SAMPLE amp = direction * F2S(msynth[osc]->amp);
    SAMPLE last_amp = direction * F2S(msynth[osc]->last_amp);
    // LOCAL EDIT (S3-Amysynth, experimental): unison cluster - the two-pass
    // body runs once per copy on that copy's phase; last_duty is shared, so it
    // advances once after the loop.
    unison_copy copies[AMY_UNISON_MAX];
    uint8_t n = unison_prepare(osc, copies, freq, last_amp, amp);
    float duty = 0;
    if (is_square) {
        duty = msynth[osc]->duty;
        if (duty < 0.01f) duty = 0.01f;
        if (duty > 0.99f) duty = 0.99f;
    }
    SAMPLE max_value = 0;
    for (uint8_t i = 0; i < n; ++i) {
        PHASOR *phase = unison_phase(osc, i);
        PHASOR pwm_phase = *phase;
        // LOCAL EDIT (S3-Amysynth): copy 0 keeps the cubic kernel, so a
        // plain (count 1) saw or pulse renders exactly as upstream; the
        // detuned copies use the linear kernel, 2.3x cheaper per sample and
        // inaudibly different under the per-period LUT choice.
        if (i == 0)
            *phase = render_lut_cub_sized(buf, *phase, copies[i].step, copies[i].last_amp, copies[i].amp, synth[osc]->lut, &max_value);
        else
            *phase = render_lut_sized(buf, *phase, copies[i].step, copies[i].last_amp, copies[i].amp, synth[osc]->lut, &max_value);
        if (is_square) {  // For pulse only, add a second delayed negative LUT wave.
            pwm_phase = P_WRAPPED_SUM(pwm_phase, F2P(msynth[osc]->last_duty));
            // Second pulse is given some blockwise-constant FM to maintain phase continuity across blocks.
            PHASOR delta_phase_per_sample = F2P((duty - msynth[osc]->last_duty) / AMY_BLOCK_SIZE);
            if (i == 0)
                render_lut_cub_sized(buf, pwm_phase, copies[i].step + delta_phase_per_sample, -copies[i].last_amp, -copies[i].amp, synth[osc]->lut, &max_value);
            else
                render_lut_sized(buf, pwm_phase, copies[i].step + delta_phase_per_sample, -copies[i].last_amp, -copies[i].amp, synth[osc]->lut, &max_value);
        }
    }
    if (is_square) msynth[osc]->last_duty = duty;
    // Remember last_amp.
    msynth[osc]->last_amp = msynth[osc]->amp;
    AMY_PROFILE_STOP(RENDER_LPF_LUT)
    return max_value;
}

SAMPLE render_pulse(SAMPLE* buf, uint16_t osc) {
    // Second (negative) impulse is <duty> cycles later.
    _pulse_note_on(osc);
    return render_lpf_lut(buf, osc, true, 1, 0);
}

void pulse_mod_trigger(uint16_t osc) {
    //float mod_sr = (float)AMY_SAMPLE_RATE / (float)AMY_BLOCK_SIZE;
    //float freq = freq_of_logfreq(synth[osc]->logfreq);
    //float period = 1. / (freq/mod_sr);
}

// dpwe sez to use this method for low-freq mod pulse still 
SAMPLE compute_mod_pulse(uint16_t osc) {
    // do BW pulse gen at SR=44100/64
    SAMPLE sample;
    if(msynth[osc]->duty < 0.001f || msynth[osc]->duty > 0.999f) msynth[osc]->duty = 0.5;
    if(synth[osc]->phase >= F2P(msynth[osc]->duty)) {
        sample = F2S(1.0f);
    } else {
        sample = F2S(-1.0f);
    }
    float mod_sr = (float)AMY_SAMPLE_RATE / (float)AMY_BLOCK_SIZE;  // samples per sec / samples per call = calls per sec
    float freq = freq_of_logfreq(msynth[osc]->logfreq);
    synth[osc]->phase = P_WRAPPED_SUM(synth[osc]->phase, F2P(freq * (1.0f / mod_sr)));  // cycles per sec / calls per sec = cycles per call.  LOCAL EDIT: folded divide
    return MULA_SS(sample, F2S(msynth[osc]->amp));
}


/* Saw waves */
void saw_note_on(uint16_t osc, int8_t direction_notused, float freq) {
    // Dummy, now done lazily.
    synth[osc]->lut = NULL;
}

void _saw_note_on(uint16_t osc) {
    //printf("saw_note_on: time %lld osc %d freq %f logfreq %f amp %f last_amp %f phase %f\n", amy_global.total_blocks*AMY_BLOCK_SIZE, osc, freq, synth[osc]->logfreq, msynth[osc]->amp, msynth[osc]->last_amp, P2F(synth[osc]->phase));
    if (synth[osc]->lut == NULL) {
        float freq = freq_of_logfreq(msynth[osc]->logfreq);
        float period_samples = ((float)AMY_SAMPLE_RATE / freq);
        synth[osc]->lut = choose_from_lutset(period_samples, saw_fxpt_lutset);
    }
}

void saw_down_note_on(uint16_t osc, float freq) {
    saw_note_on(osc, -1, freq);
}
void saw_up_note_on(uint16_t osc, float freq) {
    saw_note_on(osc, 1, freq);
}

SAMPLE render_saw(SAMPLE* buf, uint16_t osc, int8_t direction) {
    _saw_note_on(osc);
    return render_lpf_lut(buf, osc, false, direction, /* dc offset */ 0);
    //printf("render_saw: time %lld osc %d buf[]=%f %f %f %f %f %f %f %f\n",
    //       amy_global.total_blocks*AMY_BLOCK_SIZE, osc, S2F(buf[0]), S2F(buf[1]), S2F(buf[2]), S2F(buf[3]), S2F(buf[4]), S2F(buf[5]), S2F(buf[6]), S2F(buf[7]));
}

SAMPLE render_saw_down(SAMPLE* buf, uint16_t osc) {
    return render_saw(buf, osc, -1);
}
SAMPLE render_saw_up(SAMPLE* buf, uint16_t osc) {
    return render_saw(buf, osc, 1);
}


void saw_mod_trigger(uint16_t osc) {
    //float mod_sr = (float)AMY_SAMPLE_RATE / (float)AMY_BLOCK_SIZE;
    //float freq = freq_of_logfreq(synth[osc]->logfreq);
    //float period = 1. / (freq/mod_sr);
}

void saw_up_mod_trigger(uint16_t osc) {
    saw_mod_trigger(osc);
}
void saw_down_mod_trigger(uint16_t osc) {
    saw_mod_trigger(osc);
}

// TODO -- this should use dpwe code
SAMPLE compute_mod_saw(uint16_t osc, int8_t direction) {
    // Saw waveform is just the phasor.
    SAMPLE sample = SHIFTL(P2S(synth[osc]->phase), 1) - F2S(1.0f);
    float mod_sr = (float)AMY_SAMPLE_RATE / (float)AMY_BLOCK_SIZE;  // samples per sec / samples per call = calls per sec
    float freq = freq_of_logfreq(msynth[osc]->logfreq);
    synth[osc]->phase = P_WRAPPED_SUM(synth[osc]->phase, F2P(freq * (1.0f / mod_sr)));  // cycles per sec / calls per sec = cycles per call.  LOCAL EDIT: folded divide
    return MULA_SS(sample, direction * F2S(msynth[osc]->amp));
}

SAMPLE compute_mod_saw_down(uint16_t osc) {
    return compute_mod_saw(osc, -1);
}

SAMPLE compute_mod_saw_up(uint16_t osc) {
    return compute_mod_saw(osc, 1);
}



/* triangle wave */
void triangle_note_on(uint16_t osc, float freq) {
    // switched to lazy
    synth[osc]->lut = NULL;
}
    
void _triangle_note_on(uint16_t osc, float freq) {
    if (synth[osc]->lut == NULL) {
        float period_samples = (float)AMY_SAMPLE_RATE / freq;
        synth[osc]->lut = choose_from_lutset(period_samples, triangle_fxpt_lutset);
    }
}

SAMPLE render_triangle(SAMPLE* buf, uint16_t osc) {
    float freq = freq_of_logfreq(msynth[osc]->logfreq);
    _triangle_note_on(osc, freq);
    SAMPLE amp = F2S(msynth[osc]->amp);
    SAMPLE last_amp = F2S(msynth[osc]->last_amp);
    // LOCAL EDIT (S3-Amysynth, experimental): unison cluster.
    unison_copy copies[AMY_UNISON_MAX];
    uint8_t n = unison_prepare(osc, copies, freq, last_amp, amp);
    SAMPLE max_value = 0;
    for (uint8_t i = 0; i < n; ++i) {
        PHASOR *phase = unison_phase(osc, i);
        *phase = render_lut(buf, *phase, copies[i].step, copies[i].last_amp, copies[i].amp, synth[osc]->lut, &max_value);
    }
    msynth[osc]->last_amp = msynth[osc]->amp;
    return max_value;
}

void triangle_mod_trigger(uint16_t osc) {
    // float mod_sr = (float)AMY_SAMPLE_RATE / (float)AMY_BLOCK_SIZE;
    // float freq = freq_of_logfreq(synth[osc]->logfreq);
    // float period = 1. / (freq/mod_sr);
}

// TODO -- this should use dpwe code 
SAMPLE compute_mod_triangle(uint16_t osc) {
    // Offset phase by 1/4 cycle for Triangle waveform in "sine phase" (starts at 0).
    SAMPLE sample = SHIFTL(P2S(synth[osc]->phase), 2) + F2S(1.0f);  // 1..5
    if (sample > F2S(4.0f))  sample -= F2S(4.0f);  // 1..4/0..1
    if (sample > F2S(2.0f))  sample = F2S(4.0f) - sample;  // 0..2..0
    sample -= F2S(1.0f);  // -1 .. 1
    float mod_sr = (float)AMY_SAMPLE_RATE / (float)AMY_BLOCK_SIZE;  // samples per sec / samples per call = calls per sec
    float freq = freq_of_logfreq(msynth[osc]->logfreq);
    synth[osc]->phase = P_WRAPPED_SUM(synth[osc]->phase, F2P(freq * (1.0f / mod_sr)));  // cycles per sec / calls per sec = cycles per call.  LOCAL EDIT: folded divide
    return MULA_SS(sample, F2S(msynth[osc]->amp));
}


/* FM */
// NB this uses new lingo for step, skip, phase etc
void fm_sine_note_on(uint16_t osc, uint16_t algo_osc) {
    // lazy
    synth[osc]->lut = NULL;
}

void _fm_sine_note_on(uint16_t osc, float freq) {
    if (synth[osc]->lut == NULL) {
        float period_samples = (float)AMY_SAMPLE_RATE / freq;
        synth[osc]->lut = choose_from_lutset(period_samples, sine_fxpt_lutset);
    }
}

SAMPLE render_fm_sine(SAMPLE* buf, uint16_t osc, SAMPLE* mod, SAMPLE feedback_level, uint16_t algo_osc, SAMPLE mod_amp) {
    if(AMY_IS_SET(synth[osc]->logratio)) {
        msynth[osc]->logfreq = msynth[algo_osc]->logfreq + synth[osc]->logratio;
    }
    float freq = freq_of_logfreq(msynth[osc]->logfreq);
    _fm_sine_note_on(osc, freq);
    PHASOR step = F2P(freq * (1.0f / (float)AMY_SAMPLE_RATE));  // cycles per sec / samples per sec -> cycles per sample.  LOCAL EDIT: folded divide
    SAMPLE amp = MUL8_SS(F2S(msynth[osc]->amp), mod_amp);
    SAMPLE last_amp = MUL8_SS(F2S(msynth[osc]->last_amp), mod_amp);
    SAMPLE max_value;
    if (feedback_level > 0 && mod)
        synth[osc]->phase = render_lut_fm_fb(buf, synth[osc]->phase, step,
                                            last_amp, amp,
                                            synth[osc]->lut,
                                            mod, feedback_level, synth[osc]->last_two, &max_value);
    else if (feedback_level > 0)
        synth[osc]->phase = render_lut_fb(buf, synth[osc]->phase, step,
                                         last_amp, amp,
                                         synth[osc]->lut,
                                         feedback_level, synth[osc]->last_two, &max_value);
    else if (mod)
        synth[osc]->phase = render_lut_fm(buf, synth[osc]->phase, step,
                                         last_amp, amp,
                                         synth[osc]->lut,
                                         mod, &max_value);
    else
        //synth[osc]->phase = render_lut(buf, synth[osc]->phase, step,
        //                              last_amp, amp,
        //                              synth[osc]->lut, &max_value);
        synth[osc]->phase = render_lut_256(buf, synth[osc]->phase, step,
                                           last_amp, amp,
                                           /* synth[osc]->lut */ &sine_fxpt_lutset[0], &max_value);

    msynth[osc]->last_amp = msynth[osc]->amp;
    return max_value;
}

/* sine */
void sine_note_on(uint16_t osc, float freq) {
    // functionality now allocated lazily
    synth[osc]->lut = NULL;
}

void _sine_note_on(uint16_t osc, float freq) {
    //fprintf(stderr, "sine_note_on: time %f osc %d freq %f\n", amy_global.total_blocks*AMY_BLOCK_SIZE / (float)AMY_SAMPLE_RATE, osc, freq_of_logfreq(synth[osc]->logfreq_coefs[0]));
    // There's really only one sine table, but for symmetry with the other ones...
    if (synth[osc]->lut == NULL) {
        float period_samples = (float)AMY_SAMPLE_RATE / freq;
        synth[osc]->lut = choose_from_lutset(period_samples, sine_fxpt_lutset);
    }
}

SAMPLE render_sine(SAMPLE* buf, uint16_t osc) { 
    float freq = freq_of_logfreq(msynth[osc]->logfreq);
    _sine_note_on(osc, freq);
    SAMPLE amp = F2S(msynth[osc]->amp);
    SAMPLE last_amp = F2S(msynth[osc]->last_amp);
    // LOCAL EDIT (S3-Amysynth, experimental): unison cluster.
    unison_copy copies[AMY_UNISON_MAX];
    uint8_t n = unison_prepare(osc, copies, freq, last_amp, amp);
    SAMPLE max_value = 0;
    for (uint8_t i = 0; i < n; ++i) {
        PHASOR *phase = unison_phase(osc, i);
        //*phase = render_lut(buf, *phase, copies[i].step, copies[i].last_amp, copies[i].amp, synth[osc]->lut, &max_value);
        *phase = render_lut_256(buf, *phase, copies[i].step, copies[i].last_amp, copies[i].amp, /* synth[osc]->lut */ &sine_fxpt_lutset[0], &max_value);
    }
    msynth[osc]->last_amp = msynth[osc]->amp;
    return max_value;
}


// TOOD -- not needed anymore
SAMPLE compute_mod_sine(uint16_t osc) { 
    // One sample pulled out of render_lut.
    float freq = freq_of_logfreq(msynth[osc]->logfreq);
    _sine_note_on(osc, freq);
    const LUT *lut = synth[osc]->lut;
    if (lut == NULL) return 0;   // Avoid bus error if somehow the osc is not set up yet.
    int lut_mask = lut->table_size - 1;
    int lut_bits = lut->log_2_table_size;
    int16_t base_index = INT_OF_P(synth[osc]->phase, lut_bits);
    SAMPLE frac = S_FRAC_OF_P(synth[osc]->phase, lut_bits);
    LUTSAMPLE b = lut->table[base_index];
    LUTSAMPLE c = lut->table[(base_index + 1) & lut_mask];
    SAMPLE sample = L2S(b) + MUL0_SS(L2S(c - b), frac);
    float mod_sr = (float)AMY_SAMPLE_RATE / (float)AMY_BLOCK_SIZE;  // samples per sec / samples per call = calls per sec
    synth[osc]->phase = P_WRAPPED_SUM(synth[osc]->phase, F2P(freq * (1.0f / mod_sr)));  // cycles per sec / calls per sec = cycles per call.  LOCAL EDIT: folded divide
    return MULA_SS(sample, F2S(msynth[osc]->amp));
}

void sine_mod_trigger(uint16_t osc) {
    sine_note_on(osc, freq_of_logfreq(msynth[osc]->logfreq));
}


// On the RP2040, rand and mrand48 etc. don't work on core1.
// I think this is to do with the implicit state - it's not repeatable, nor strictly safe,
// to potentially have two cores accessing the same rand_state memory at the same time.
// However, we just want random values, and any bit pattern is acceptable.
// So we make our own implementation of mrand48, and don't worry about it being called from both cores.

static uint64_t rand_state = 0;
static const uint64_t a = 0x5deece66dL;
static const uint32_t c = 0xb;

void my_srand48(uint32_t seedval) {
    rand_state = ((uint64_t)seedval) << 32L;
}

static inline int32_t my_mrand48(void) {
    // per https://www.ibm.com/docs/en/zos/2.4.0?topic=functions-mrand48-pseudo-random-number-generator
    rand_state = (a * rand_state + c) & 0x0000ffffffffffffL;
    return (int32_t)rand_state;
}

#if (defined PICO_RP2350) || (defined PICO_RP2040)
#include "pico/rand.h"
#endif

// Returns a SAMPLE between -1 and 1.
inline static SAMPLE amy_get_random() {
#ifndef AMY_USE_FIXEDPOINT
    return ((float)drand48()) - 0.5f;
#else
    //assert(RAND_MAX == 2147483647); // 2^31 - 1
    return SHIFTR((SAMPLE)my_mrand48(), (32 - S_FRAC_BITS));  // - F2S(0.5f);
#endif
}

/* noise */

void noise_note_on(uint16_t osc) {
    synth[osc]->last_two[0] = 0;
    synth[osc]->last_two[1] = 0;
}

SAMPLE render_noise(SAMPLE *buf, uint16_t osc) {
    SAMPLE amp = F2S(msynth[osc]->amp);
    SAMPLE max_value = 0;
    SAMPLE last_white = synth[osc]->last_two[0];
    SAMPLE last_last_white = synth[osc]->last_two[1];
    for(uint16_t i=0;i<AMY_BLOCK_SIZE;i++) {
        SAMPLE white = MULA_SS(amy_get_random(), amp);
        // Two-zero LPF to make the noise a little more pink, closer to Juno noise.
        SAMPLE value = white + last_white + last_white + last_last_white;
        last_last_white = last_white;
        last_white = white;
        buf[i] += value;
        if (value < 0) value = -value;
        if (value > max_value) max_value = value;
    }
    synth[osc]->last_two[0] = last_white;
    synth[osc]->last_two[1] = last_last_white;
    return max_value;
}

SAMPLE compute_mod_noise(uint16_t osc) {
    float mod_sr = (float)AMY_SAMPLE_RATE / (float)AMY_BLOCK_SIZE;
    float freq = freq_of_logfreq(msynth[osc]->logfreq);
    float fstep = freq * (1.0f / mod_sr);  // LOCAL EDIT: folded divide
    SAMPLE amp = F2S(msynth[osc]->amp);
    PHASOR starting_phase = synth[osc]->phase;
    synth[osc]->phase = P_WRAPPED_SUM(synth[osc]->phase, F2P(fstep));  // cycles per sec / calls per sec = cycles per call
    if (fstep > 1.0f || synth[osc]->phase < starting_phase) {
        // phase wrapped, take new sample.
        synth[osc]->last_two[0] = MULA_SS(amy_get_random(), amp);
    }
    //printf("mod_noise: time %lld fstep %f samp %f\n", amy_global.total_blocks*AMY_BLOCK_SIZE, fstep, S2F(synth[osc]->last_two[0]));
    return synth[osc]->last_two[0];
}

/* silent, i.e. just apply envelope */
SAMPLE render_envelope(SAMPLE *buf, uint16_t osc) {
    SAMPLE incoming_amp = F2S(msynth[osc]->last_amp);
    SAMPLE ending_amp = F2S(msynth[osc]->amp);
    SAMPLE max_value = 0;
    SAMPLE current_amp = incoming_amp;
    SAMPLE incremental_amp = SHIFTR(ending_amp - incoming_amp, BLOCK_SIZE_BITS);
    for(uint16_t i = 0; i < AMY_BLOCK_SIZE; i++) {
        SAMPLE value = MULA_SS(buf[i], current_amp);
        buf[i] = value;
        if (value < 0) value = -value;
        if (value > max_value) max_value = value;
        current_amp += incremental_amp;
    }
    msynth[osc]->last_amp = msynth[osc]->amp;
    return max_value;
}


/* partial */

void partial_note_on(uint16_t osc) {
    synth[osc]->lut = NULL;
}

//void _partial_note_on(uint16_t osc, float freq) {
//    if (synth[osc]->lut == NULL) {
//        float period_samples = (float)AMY_SAMPLE_RATE / freq;
//        synth[osc]->lut = choose_from_lutset(period_samples, sine_fxpt_lutset);
//    }
//}

AMY_IRAM_ATTR SAMPLE render_partial(SAMPLE * buf, uint16_t osc) {
    float freq = freq_of_logfreq(msynth[osc]->logfreq);
    //_partial_note_on(osc, freq);
    //synth[osc]->lut = sine_fxpt_lutset[0];  // we know there's only one.
    PHASOR step = F2P(freq * (1.0f / (float)AMY_SAMPLE_RATE));  // cycles per sec / samples per sec -> cycles per sample.  LOCAL EDIT: folded divide
    SAMPLE amp = F2S(msynth[osc]->amp);
    SAMPLE last_amp = F2S(msynth[osc]->last_amp);
    //printf("render_partial: time %.3f logfreq %f freq %f last_amp %f amp %f step %f\n", (float)amy_global.total_blocks*AMY_BLOCK_SIZE/(float)AMY_SAMPLE_RATE, msynth[osc]->logfreq, freq, S2F(last_amp), S2F(amp), P2F(step) * synth[osc]->lut->table_size);
    SAMPLE max_value;
    //synth[osc]->phase = render_lut(buf, synth[osc]->phase, step, last_amp, amp, /* synth[osc]->lut */ &sine_fxpt_lutset[0], &max_value);
    synth[osc]->phase = render_lut_256(buf, synth[osc]->phase, step, last_amp, amp, /* synth[osc]->lut */ &sine_fxpt_lutset[0], &max_value);
    msynth[osc]->last_amp = msynth[osc]->amp;
    return max_value;
}

void partial_note_off(uint16_t osc) {
    AMY_UNSET(synth[osc]->note_on_clock);
    synth[osc]->note_off_clock = amy_global.total_blocks*AMY_BLOCK_SIZE;
    msynth[osc]->last_amp = 0;
    synth[osc]->status = SYNTH_OFF;
}


#define KS_LOWEST_FREQ 55 // 55Hz (A1) lowest note we can play
// One period of KS_LOWEST_FREQ, so the ring holds any note we admit at any
// sample rate.  A literal sized for 44100 truncates the ring above it.
#define MAX_KS_BUFFER_LEN (AMY_SAMPLE_RATE / KS_LOWEST_FREQ + 1)
SAMPLE ** ks_buffer;
// Loop-allpass memories, one row per ring, sized for the maximum stage count
// so the count can change at runtime without an allocation.  Element 0 is the
// tuning stage, 1..KS_DISPERSION_MAX_STAGES the dispersion chain.
static SAMPLE *ks_ap_state;
// Which osc each ring belongs to.  A ring is a physical string: two oscs
// playing one ring damp each other's decay and re-excite each other on
// note-on, so the mapping has to be per osc rather than a shared cursor.
// The claim is two-way -- ks_row_owner[r] == osc AND synth[osc]->ks_index == r
// -- so resetting or freeing an osc releases its ring with no explicit undo.
static uint16_t *ks_row_owner;
#define KS_ROW_UNOWNED 0xFFFF

// The loop allpass, global to every string: one tuning stage completing the
// fractional period, then `stages` stages sharing a coefficient g whose
// phase delay falls with frequency, so the upper modes drift sharp of the
// harmonic series the way a stiff string's do.  g follows the note:
// ks_loop_set() designs one per semitone for the stiffness B (mode k of a
// stiff string sits at k f sqrt(1 + B k^2)), and the string interpolates it.
// Written by ks_loop_set() under the lock, read once per block.
#define KS_DISP_NOTES 97        // semitones up from KS_LOWEST_FREQ
#define KS_DISP_G_MIN -0.95f    // design limit; stiffer notes saturate here
static struct {
    bool tune;          // run the fractional-period tuning stage
    uint8_t stages;     // dispersion stages, 0..KS_DISPERSION_MAX_STAGES
    float stiffness;    // inharmonicity B; 0 runs no dispersion stage
    float g[KS_DISP_NOTES];  // stage coefficient per semitone
} ks_loop = { true, 0, 1e-3f, { 0 } };
_Static_assert(KS_DISPERSION_MAX_STAGES == 3, "render_ks unrolls the chain to three stages");

// Excitation shaping, global to every string.  The burst is a mix of the
// noise, combed (to depth `comb`) to notch the harmonics a pluck at `pick` of
// the string length leaves out, and a pulse `pick` of the period wide -- the force an ideal
// pluck puts on the bridge, whose spectrum is the same notches on a 1/n
// slope and is the same on every note.  A one-pole lowpass then follows velocity, its
// cutoff in harmonics of the note running from `soft` at velocity 0 to `hard`
// at velocity 1.  Zeros are the unshaped burst.  Written by ks_excite_set()
// under the lock, read by ks_note_on.
static struct {
    float soft;         // lowpass cutoff at velocity 0, harmonics; 0 = no lowpass
    float hard;         // at velocity 1
    float pick;         // pick position, fraction of the ring, 0..0.5; 0 = no comb, no pulse
    float shape;        // pulse share of the burst, 0 = noise .. 1 = pulse
    float comb;         // comb depth, 0 = none .. 1 = full notches
} ks_excite = { 0.0f, 0.0f, 0.0f, 0.0f, 0.0f };


/* karplus-strong */

// True if nothing is currently sounding on ring r.
static bool ks_row_is_free(uint8_t r) {
    uint16_t owner = ks_row_owner[r];
    if (owner == KS_ROW_UNOWNED) return true;
    if (synth[owner] == NULL) return true;            // osc was freed
    if (synth[owner]->ks_index != r) return true;     // osc reset, or took another ring
    if (synth[owner]->wave != KS) return true;        // osc switched wave
    if (synth[owner]->status == SYNTH_OFF) return true;
    return false;
}

// Pick the ring this note will play.  In order: the one this osc already owns
// (a retrigger re-excites its own string, which is the common case and never
// disturbs anyone else), then any idle ring, then -- only if every ring is
// sounding -- the quietest one, because that is the collision least likely to
// be heard.
static uint8_t ks_alloc_row(uint16_t osc) {
    uint8_t own = synth[osc]->ks_index;
    if (own < AMY_KS_OSCS && ks_row_owner[own] == osc) return own;
    for (uint8_t r = 0; r < AMY_KS_OSCS; ++r) {
        if (ks_row_is_free(r)) return r;
    }
    uint8_t quietest = 0;
    float lowest = msynth[ks_row_owner[0]]->amp;
    for (uint8_t r = 1; r < AMY_KS_OSCS; ++r) {
        float amp = msynth[ks_row_owner[r]]->amp;
        if (amp < lowest) { lowest = amp; quietest = r; }
    }
    return quietest;
}

// Phase delay in samples of the allpass (g + z^-1)/(1 + g z^-1) at w
// radians per sample, 0 < w < pi, with s and c its sine and cosine.
static float ks_ap_delay_sc(float g, float w, float s, float c) {
    return (atan2f(-g * s, 1.0f + g * c) - atan2f(-s, g + c)) / w;
}

static float ks_ap_delay(float g, float w) {
    return ks_ap_delay_sc(g, w, sinf(w), cosf(w));
}

// Modes 1..n of one note, where a string of the design stiffness has them,
// and the delay one stage must lose from mode 1 to each to put it there.
#define KS_DISP_FIT_MODES 8
typedef struct {
    int n;
    float w[KS_DISP_FIT_MODES], s[KS_DISP_FIT_MODES], c[KS_DISP_FIT_MODES];
    float need[KS_DISP_FIT_MODES];
} ks_disp_fit_t;

static float ks_disp_misfit(float g, const ks_disp_fit_t *t) {
    float d1 = ks_ap_delay_sc(g, t->w[0], t->s[0], t->c[0]);
    float e = 0.0f;
    for(int k = 1; k < t->n; k++) {
        float d = d1 - ks_ap_delay_sc(g, t->w[k], t->s[k], t->c[k]) - t->need[k];
        e += d * d;
    }
    return e;
}

// The coefficient of `stages` equal stages that best places modes 2..8 of a
// note at f where a string of stiffness B has them, relative to the
// fundamental (least squares on delay, which weighs every mode's cents about
// equally).  Modes above about 4 kHz are left out: the loop's own lowpass
// leaves little of them to hear.  A first-order stage cannot follow the
// stiff-string curve far, so past B of a few 1e-3 the fit overshoots the low
// modes, and at KS_DISP_G_MIN low notes saturate.
static float ks_disp_design(float f, float B, uint8_t stages) {
    ks_disp_fit_t t;
    int K = (int)(4000.0f / f);
    if(K > KS_DISP_FIT_MODES) K = KS_DISP_FIT_MODES;
    if(K < 2) K = 2;
    float P = (float)AMY_SAMPLE_RATE / f;
    t.n = 0;
    for(int k = 1; k <= K; k++) {
        float stretch = sqrtf((1.0f + B * (float)(k * k)) / (1.0f + B));
        float w = 2.0f * (float)M_PI * f * (float)k * stretch / (float)AMY_SAMPLE_RATE;
        if(w >= (float)M_PI) break;
        t.w[t.n] = w;
        t.s[t.n] = sinf(w);
        t.c[t.n] = cosf(w);
        t.need[t.n] = P * (1.0f - 1.0f / stretch) / (float)stages;
        t.n++;
    }
    if(t.n < 2) return 0.0f;
    // Golden-section search over [KS_DISP_G_MIN, 0].
    const float r = 0.618034f;
    float a = KS_DISP_G_MIN, b = 0.0f;
    float x1 = b - r * (b - a), x2 = a + r * (b - a);
    float e1 = ks_disp_misfit(x1, &t), e2 = ks_disp_misfit(x2, &t);
    for(int i = 0; i < 20; i++) {
        if(e1 < e2) {
            b = x2; x2 = x1; e2 = e1;
            x1 = b - r * (b - a); e1 = ks_disp_misfit(x1, &t);
        } else {
            a = x1; x1 = x2; e1 = e2;
            x2 = a + r * (b - a); e2 = ks_disp_misfit(x2, &t);
        }
    }
    return 0.5f * (a + b);
}

// Ring length for freq with the dispersion chain's delay at the fundamental
// taken out of the ring, so the loop still closes at one period.  *frac_period
// receives what is left, the length the tuning stage completes, and *coef the
// chain's coefficient for this note.  If the chain would leave fewer than two
// ring samples, or the stiffness is 0, the chain is dropped for this call
// (*stages = 0) and the ring holds the whole period.
static uint16_t ks_ring_len(float freq, uint8_t *stages, float *frac_period, SAMPLE *coef) {
    float P = (float)AMY_SAMPLE_RATE / freq;
    float Pr = P;
    *coef = 0;
    if(ks_loop.stiffness <= 0.0f) *stages = 0;
    if(*stages > 0) {
        float s = 12.0f * log2f(freq / (float)KS_LOWEST_FREQ);
        if(s < 0.0f) s = 0.0f;
        if(s > (float)(KS_DISP_NOTES - 1)) s = (float)(KS_DISP_NOTES - 1);
        int i = (int)s;
        if(i > KS_DISP_NOTES - 2) i = KS_DISP_NOTES - 2;
        float g = ks_loop.g[i] + (s - (float)i) * (ks_loop.g[i + 1] - ks_loop.g[i]);
        Pr = P - (float)*stages * ks_ap_delay(g, 2.0f * (float)M_PI * freq / (float)AMY_SAMPLE_RATE);
        if(Pr < 2.0f) { *stages = 0; Pr = P; }
        else *coef = F2S(g);
    }
    uint16_t buflen = (uint16_t)Pr;
    if(buflen > MAX_KS_BUFFER_LEN) buflen = MAX_KS_BUFFER_LEN;
    *frac_period = Pr;
    return buflen;
}


// The default KS loop: tuning allpass, no dispersion. The block is split at
// the ring's wrap, so the inner loop needs no wrap test: with the ring
// pointer, output pointer and gain ramp it fits the registers and compiles to
// a hardware loop. Kept out of render_ks so the other loop's state does not
// crowd its registers. The sample after the wrap takes ring[0] as its
// neighbour; a read position past a shrunk ring makes stop < o, skips the run
// and wraps at once, as the index form does. *w0p is the allpass memory.
static __attribute__((noinline)) SAMPLE ks_render_tuned(SAMPLE *buf, uint16_t osc,
        SAMPLE *ring, uint16_t buflen, SAMPLE a, SAMPLE *w0p) {
    SAMPLE half = MUL0_SS(F2S(0.5f), F2S(synth[osc]->feedback));
    SAMPLE current_amp = F2S(msynth[osc]->last_amp);
    SAMPLE incremental_amp = SHIFTR(F2S(msynth[osc]->amp) - current_amp, BLOCK_SIZE_BITS);
    SAMPLE max_value = 0;
    SAMPLE w0 = *w0p;
    SAMPLE *p = ring + (uint16_t)synth[osc]->phase;
    SAMPLE *last = ring + buflen - 1;
    SAMPLE *o = buf, *bend = buf + AMY_BLOCK_SIZE;
    while (o < bend) {
        SAMPLE *stop = o + (last - p);
        if (stop > bend) stop = bend;
        while (o < stop) {
            SAMPLE sample = p[0];
            SAMPLE v = SMULR7((sample + p[1]), half);
            // One-multiply allpass, (a + z^-1) / (1 + a z^-1).
            SAMPLE m = SMULR7(a, v - w0);
            p[0] = m + w0;
            w0 = v + m;
            p++;
            SAMPLE value = SMULR7(sample, current_amp);
            current_amp += incremental_amp;
            *o++ += value;
            if (value < 0) value = -value;
            if (value > max_value) max_value = value;
        }
        if (o < bend) {
            SAMPLE sample = *p;
            SAMPLE v = SMULR7((sample + ring[0]), half);
            SAMPLE m = SMULR7(a, v - w0);
            *p = m + w0;
            w0 = v + m;
            p = ring;
            SAMPLE value = SMULR7(sample, current_amp);
            current_amp += incremental_amp;
            *o++ += value;
            if (value < 0) value = -value;
            if (value > max_value) max_value = value;
        }
    }
    synth[osc]->phase = (PHASOR)(p - ring);
    *w0p = w0;
    msynth[osc]->last_amp = msynth[osc]->amp;
    return max_value;
}

SAMPLE render_ks(SAMPLE * buf, uint16_t osc) {
    SAMPLE half = MUL0_SS(F2S(0.5f), F2S(synth[osc]->feedback));
    // Ramp the gain across the block from the envelope's value at its start
    // to its value at the end, as the other oscillators do; one step per block
    // zippers an envelope and cuts a still-ringing string at note-off.
    SAMPLE incoming_amp = F2S(msynth[osc]->last_amp);
    SAMPLE ending_amp = F2S(msynth[osc]->amp);
    SAMPLE current_amp = incoming_amp;
    SAMPLE incremental_amp = SHIFTR(ending_amp - incoming_amp, BLOCK_SIZE_BITS);
    float freq = freq_of_logfreq(msynth[osc]->logfreq);
    SAMPLE max_value = 0;
    if(freq >= KS_LOWEST_FREQ && synth[osc]->ks_index < AMY_KS_OSCS) {
        // ks_loop is written under the lock the render body already holds, so
        // one read here fixes the settings for the whole block.
        bool tune = ks_loop.tune;
        uint8_t n = ks_loop.stages;
        SAMPLE g;
        float Pr;
        uint16_t buflen = ks_ring_len(freq, &n, &Pr, &g);
        SAMPLE *ring = ks_buffer[synth[osc]->ks_index];
        // The ring plus the two-tap average is buflen - 0.5 samples of delay,
        // dropping the fraction of the period.  The tuning stage adds back
        // D = Pr + 0.5 - buflen, in [0.5, 1.5) by construction, so the loop
        // closes at Pr; a = (1 - D)/(1 + D) is its phase delay at DC.
        SAMPLE a = 0;
        if(tune) {
            float D = Pr + 0.5f - (float)buflen;
            a = F2S((1.0f - D) / (1.0f + D));
        }
        SAMPLE *w = ks_ap_state + synth[osc]->ks_index * (1 + KS_DISPERSION_MAX_STAGES);
        SAMPLE w0 = w[0];
        if(tune && n == 0) return ks_render_tuned(buf, osc, ring, buflen, a, w);
        // Tune off or dispersion stages on (DEV > KS loop).
        // LOCAL EDIT (S3-Amysynth): the ring index stays in a register for
        // the block and wraps by compare instead of the iterative hardware
        // remainder; an index past a shrunk buflen wraps to 0 as before.
        uint16_t index = (uint16_t)synth[osc]->phase;
        for(uint16_t i = 0; i < AMY_BLOCK_SIZE; i++) {
            uint16_t next = index + 1;
            if (next >= buflen) next = 0;
            SAMPLE sample = ring[index];
            SAMPLE v = SMULR7((sample + ring[next]), half);
            if(tune) {
                // Same one-multiply form as the default loop, so the state in
                // w0 means the same thing to both.
                SAMPLE m = SMULR7(a, v - w0);
                SAMPLE y = m + w0;
                w0 = v + m;
                v = y;
            }
            // Unrolled: a nested loop here costs the sample loop its
            // hardware-loop form.
            if(n) {
                v = allpass1_chain(v, g, w + 1, 1);
                if(n > 1) v = allpass1_chain(v, g, w + 2, 1);
                if(n > 2) v = allpass1_chain(v, g, w + 3, 1);
            }
            ring[index] = v;
            index = next;
            SAMPLE value = SMULR7(sample, current_amp);
            current_amp += incremental_amp;
            buf[i] += value;
            if (value < 0) value = -value;
            if (value > max_value) max_value = value;
        }
        synth[osc]->phase = (PHASOR)index;
        w[0] = w0;
    }
    msynth[osc]->last_amp = msynth[osc]->amp;
    //fprintf(stderr, "render_ks time %u osc %d freq %.1f amp %.3f maxval %.3f\n", amy_global.total_blocks*AMY_BLOCK_SIZE, osc, freq, S2F(amp), S2F(max_value));
    return max_value;
}

// Pluck position from duty's constant coefficient, read at note-on.
// b = |duty - 0.5| is the pluck point as a fraction of the string; duty and
// 1 - duty pluck the same point from either end, and the reset default 0.5
// leaves the plain noise burst.  The burst becomes the noise, combed to notch
// the harmonics a pluck at b leaves out, mixed with a pulse b of the period
// wide (an ideal pluck's force on the bridge: the same notches on a 1/n
// slope, identical on every note).  Both ease in below KS_PICK_RAMP.
#define KS_PICK_MIX  0.6f   // pulse share of the burst once eased in
#define KS_PICK_RAMP 0.1f   // pick position below which pulse and comb ease in

// One in-place pass: remove the mean, comb (circular, so the notches land on
// harmonics), rescale and add the pulse.  Walking each cycle of i -> i - M
// reads x[i - M] before it is overwritten; only the cycle's start is saved.
// Scales come from the fill's expected RMS, so the per-sample work is fixed
// point.
static void ks_pluck(SAMPLE *ring, uint16_t buflen, uint16_t M, float b, SAMPLE mean) {
    float r = (b < KS_PICK_RAMP) ? b / KS_PICK_RAMP : 1.0f;
    float s = KS_PICK_MIX * r;              // pulse share
    float g = r;                            // comb depth
    float p = (float)M / (float)buflen;     // pulse duty as rendered
    // The uniform +/-0.5 fill has RMS 1/sqrt(12); the comb scales it by
    // sqrt(1 + g^2); a unit pulse of duty p has RMS sqrt(p (1 - p)).  d keeps
    // the mix at the fill's RMS.
    float d = sqrtf((1.0f - s) * (1.0f - s) + s * s);
    float kn = (1.0f - s) / (sqrtf(1.0f + g * g) * d);
    float kp = s * 0.28867513f / (sqrtf(p * (1.0f - p)) * d);
    SAMPLE kn_s = F2S(kn), g_s = F2S(g);
    SAMPLE hi = F2S(kp * (1.0f - p)), lo = F2S(-kp * p);
    // (x[i] - mean) - g (x[i - M] - mean), with the mean term folded.
    SAMPLE dc = FILT_MUL_SS(F2S(1.0f - g), mean);
    uint16_t cycles = buflen, t = M;
    while(t) { uint16_t u = cycles % t; cycles = t; t = u; }   // gcd
    for(uint16_t c = 0; c < cycles; c++) {
        SAMPLE first = ring[c];
        uint16_t j = c;
        for(;;) {
            uint16_t k = (j >= M) ? j - M : j + buflen - M;
            SAMPLE prev = (k == c) ? first : ring[k];
            SAMPLE v = ring[j] - FILT_MUL_SS(g_s, prev) - dc;
            ring[j] = FILT_MUL_SS(kn_s, v) + ((j < M) ? hi : lo);
            if(k == c) break;
            j = k;
        }
    }
}

// Shape a freshly filled zero-mean burst in place per ks_excite, then restore
// its RMS so the shaping changes the spectrum and not the level; velocity
// still scales the output tap.  Once per note-on, in float.
static void ks_shape_burst(SAMPLE *ring, uint16_t buflen, float freq, float velocity) {
    float rms_in = 0.0f;
    for(uint16_t i = 0; i < buflen; i++) { float x = S2F(ring[i]); rms_in += x * x; }
    // Pick comb e[i] = x[i] - g x[i - M], circular so the notches land
    // exactly on harmonics.  In place with no scratch: walking each cycle of
    // i -> i - M reads x[i - M] before overwriting it, except the cycle's
    // start, which is saved.  A short M at full depth is close to a
    // differentiator (gain 2 sin(n pi M/buflen)), so a shallow depth is how
    // a pick near 0 stays close to the unshaped burst.
    uint16_t M = (uint16_t)(ks_excite.pick * (float)buflen + 0.5f);
    SAMPLE g = F2S(ks_excite.comb);
    if(M > 0 && M < buflen && ks_excite.shape < 1.0f && ks_excite.comb > 0.0f) {
        uint16_t cycles = buflen, r = M;
        while(r) { uint16_t t = cycles % r; cycles = r; r = t; }   // gcd
        for(uint16_t s = 0; s < cycles; s++) {
            SAMPLE first = ring[s];
            uint16_t j = s;
            for(;;) {
                uint16_t k = (j >= M) ? j - M : j + buflen - M;
                if(k == s) { ring[j] -= FILT_MUL_SS(g, first); break; }
                ring[j] -= FILT_MUL_SS(g, ring[k]);
                j = k;
            }
        }
    }
    if(ks_excite.shape > 0.0f && M > 0 && M < buflen) {
        // Zero-mean pulse, high for the first M samples, scaled to the
        // noise's RMS before mixing; a unit pulse of duty b has RMS
        // sqrt(b (1 - b)) about its mean.
        float noise_rms = 0.0f;
        for(uint16_t i = 0; i < buflen; i++) { float x = S2F(ring[i]); noise_rms += x * x; }
        noise_rms = sqrtf(noise_rms / (float)buflen);
        float b = (float)M / (float)buflen;
        float scale = ks_excite.shape * noise_rms / sqrtf(b * (1.0f - b));
        for(uint16_t i = 0; i < buflen; i++) {
            float t = (i < M) ? 1.0f - b : -b;
            ring[i] = F2S((1.0f - ks_excite.shape) * S2F(ring[i]) + scale * t);
        }
    }
    if(ks_excite.soft > 0.0f) {
        float v = velocity < 0.0f ? 0.0f : (velocity > 1.0f ? 1.0f : velocity);
        // Geometric in velocity: equal velocity steps are equal brightness ratios.
        float fc = freq * ks_excite.soft * powf(ks_excite.hard / ks_excite.soft, v);
        if(fc > 0.45f * (float)AMY_SAMPLE_RATE) fc = 0.45f * (float)AMY_SAMPLE_RATE;
        float k = 1.0f - expf(-6.2831853f * fc / (float)AMY_SAMPLE_RATE);
        // Circular: one pass settles the state on the ring's own tail, the
        // second writes, so no start-up transient sits at index 0.
        float y = 0.0f;
        for(uint16_t i = 0; i < buflen; i++) y += k * (S2F(ring[i]) - y);
        for(uint16_t i = 0; i < buflen; i++) { y += k * (S2F(ring[i]) - y); ring[i] = F2S(y); }
    }
    float rms_out = 0.0f;
    for(uint16_t i = 0; i < buflen; i++) { float x = S2F(ring[i]); rms_out += x * x; }
    if(rms_out > 0.0f) {
        float g = sqrtf(rms_in / rms_out);
        for(uint16_t i = 0; i < buflen; i++) ring[i] = F2S(S2F(ring[i]) * g);
    }
}

void ks_note_on(uint16_t osc, float freq) {
    // render_ks reads phase as a plain ring index, so start it at the bottom
    // of the ring.  Any other wave leaves a fixed-point phasor here, whose
    // low 16 bits index far past the buffer.
    synth[osc]->phase = 0;
    if(ks_buffer == NULL) { synth[osc]->ks_index = KS_NO_ROW; return; }
    uint8_t row = ks_alloc_row(osc);
    synth[osc]->ks_index = row;
    ks_row_owner[row] = osc;
    SAMPLE *ring = ks_buffer[row];
    // A retrigger re-excites the string from clean state, so the loop allpass
    // memories are cleared with the ring, including any stage the current
    // setting does not run.
    SAMPLE *w = ks_ap_state + row * (1 + KS_DISPERSION_MAX_STAGES);
    for(uint8_t k = 0; k < 1 + KS_DISPERSION_MAX_STAGES; k++) w[k] = 0;
    // ks_note_on runs on the render task under the lock, so a plain read of
    // ks_loop agrees with the one render_ks makes for this block.
    uint8_t n = ks_loop.stages;
    float Pr;
    SAMPLE g;
    uint16_t buflen = ks_ring_len(freq, &n, &Pr, &g);
    // init KS buffer with noise up to max
    SAMPLE sum = 0;
    for(uint16_t i = 0; i < buflen; i++) {
        SAMPLE val = amy_get_random();
        ring[i] = val;
        sum += val;
    }
    // Remove dc, to avoid ending up with a dc-offset residual.
    SAMPLE mean = sum / buflen;
    float b = fabsf(synth[osc]->duty_coefs[COEF_CONST] - 0.5f);
    if(b > 0.5f) b = 0.5f;
    uint16_t M = (uint16_t)(b * (float)buflen + 0.5f);
    if(M > 0 && M < buflen) {
        ks_pluck(ring, buflen, M, b, mean);
    } else {
        for(uint16_t i = 0; i < buflen; i++) {
            ring[i] -= mean;
        }
    }
    if(ks_excite.soft > 0.0f || ks_excite.pick > 0.0f || ks_excite.shape > 0.0f)
        ks_shape_burst(ring, buflen, freq, synth[osc]->velocity);
    //fprintf(stderr, "ks_note_on: osc %d buflen %d row %d\n", osc, buflen, row);
}

// Whether a KS note-off starts the amp envelope's release, as it does for
// the other waves.  Off, note-off leaves the string ringing on the sustain
// level and the osc never stops rendering.  Written by ks_release_set()
// under the lock, read by ks_note_off.
static bool ks_release = true;

// Returns true when the caller should start the release.
bool ks_note_off(uint16_t osc) {
    msynth[osc]->amp = 0;
    return ks_release;
}

void ks_release_set(bool on) {
    amy_grab_lock();
    ks_release = on;
    amy_release_lock();
}

bool ks_release_get(void) {
    return ks_release;
}


void ks_init(void) {
    // One ring per simultaneously sounding KS osc; ks_oscs is the polyphony
    // ceiling, past which ks_alloc_row() steals the quietest ring.
    ks_buffer = (SAMPLE**) malloc_caps(sizeof(SAMPLE*)*AMY_KS_OSCS, amy_global.config.ram_caps_synth);
    if(ks_buffer == NULL) {
        amy_oom("unable to alloc %d KS rings\n", (int)AMY_KS_OSCS);
        return;
    }
    // Before anything else can fail: ks_deinit() walks this array.
    for(int i=0;i<AMY_KS_OSCS;i++) ks_buffer[i] = NULL;
    ks_row_owner = (uint16_t*) malloc_caps(sizeof(uint16_t)*AMY_KS_OSCS, amy_global.config.ram_caps_synth);
    if(ks_row_owner == NULL) {
        amy_oom("unable to alloc %d KS ring owners\n", (int)AMY_KS_OSCS);
        ks_deinit();
        return;
    }
    for(int i=0;i<AMY_KS_OSCS;i++) ks_row_owner[i] = KS_ROW_UNOWNED;
    ks_ap_state = (SAMPLE*) malloc_caps(sizeof(SAMPLE)*AMY_KS_OSCS*(1 + KS_DISPERSION_MAX_STAGES), amy_global.config.ram_caps_synth);
    if(ks_ap_state == NULL) {
        amy_oom("unable to alloc %d KS loop allpass states\n", (int)(AMY_KS_OSCS*(1 + KS_DISPERSION_MAX_STAGES)));
        ks_deinit();
        return;
    }
    for(int i=0;i<AMY_KS_OSCS*(1 + KS_DISPERSION_MAX_STAGES);i++) ks_ap_state[i] = 0;
    // The rings are the bulk of KS memory and get their own caps; the tables
    // above are a few bytes per ring and stay with ram_caps_synth.
    for(int i=0;i<AMY_KS_OSCS;i++) {
        ks_buffer[i] = (SAMPLE*)malloc_caps(sizeof(SAMPLE)*MAX_KS_BUFFER_LEN, amy_global.config.ram_caps_ks);
        if(ks_buffer[i] == NULL) {
            // All or nothing: a partly-filled table would let ks_alloc_row()
            // hand out a NULL ring, so KS goes silent instead of half-working.
            // ks_note_on's NULL check and render_ks's ks_index guard are what
            // make silence safe.
            amy_oom("unable to alloc KS ring of %d samples\n", (int)MAX_KS_BUFFER_LEN);
            ks_deinit();
            return;
        }
    }
}

void ks_deinit(void) {
    if(ks_buffer != NULL) {
        for(int i=0;i<AMY_KS_OSCS;i++) free(ks_buffer[i]);
        free(ks_buffer);
        ks_buffer = NULL;
    }
    free(ks_row_owner);
    ks_row_owner = NULL;
    free(ks_ap_state);
    ks_ap_state = NULL;
}

// Set the loop allpass.  Call from a control task, never from the render path:
// the render body holds the lock this takes.  The settings take effect on the
// next block.  Changing the stage count or stiffness while a string sounds
// moves its ring length, so the note steps in pitch; the stage memories the
// change frees are cleared at the next note-on, not here.  The per-semitone
// design is milliseconds of float work, so it runs into a static scratch
// before the lock is taken: callers must be a single control task.
void ks_loop_set(bool tune, uint8_t stages, float stiffness) {
    static float g[KS_DISP_NOTES];
    if(stages > KS_DISPERSION_MAX_STAGES) stages = KS_DISPERSION_MAX_STAGES;
    if(stiffness < 0.0f) stiffness = 0.0f;
    if(stiffness > KS_STIFFNESS_MAX) stiffness = KS_STIFFNESS_MAX;
    for(int i = 0; i < KS_DISP_NOTES; i++) {
        g[i] = (stages > 0 && stiffness > 0.0f)
            ? ks_disp_design((float)KS_LOWEST_FREQ * exp2f((float)i / 12.0f), stiffness, stages)
            : 0.0f;
    }
    amy_grab_lock();
    ks_loop.tune = tune;
    ks_loop.stages = stages;
    ks_loop.stiffness = stiffness;
    memcpy(ks_loop.g, g, sizeof(g));
    amy_release_lock();
}

void ks_loop_get(bool *tune, uint8_t *stages, float *stiffness) {
    *tune = ks_loop.tune;
    *stages = ks_loop.stages;
    *stiffness = ks_loop.stiffness;
}

void ks_excite_set(float soft, float hard, float pick, float shape, float comb) {
    if(soft < 0.0f) soft = 0.0f;
    if(hard < soft) hard = soft;
    if(pick < 0.0f) pick = 0.0f;
    if(pick > 0.5f) pick = 0.5f;
    if(shape < 0.0f) shape = 0.0f;
    if(shape > 1.0f) shape = 1.0f;
    if(comb < 0.0f) comb = 0.0f;
    if(comb > 1.0f) comb = 1.0f;
    amy_grab_lock();
    ks_excite.soft = soft;
    ks_excite.hard = hard;
    ks_excite.pick = pick;
    ks_excite.shape = shape;
    ks_excite.comb = comb;
    amy_release_lock();
}

void ks_excite_get(float *soft, float *hard, float *pick, float *shape, float *comb) {
    *soft = ks_excite.soft;
    *hard = ks_excite.hard;
    *pick = ks_excite.pick;
    *shape = ks_excite.shape;
    *comb = ks_excite.comb;
}

// --------- wavetable ----------

#ifdef AMY_WAVETABLE
void wavetable_note_on(uint16_t osc, float freq) {
    //fprintf(stderr, "wavetable_note_on: time %f osc %d freq %f\n", amy_global.total_blocks*AMY_BLOCK_SIZE / (float)AMY_SAMPLE_RATE, osc, freq_of_logfreq(synth[osc]->logfreq_coefs[0]));
    //float period_samples = (float)AMY_SAMPLE_RATE / freq;
    //synth[osc]->lut = wavetable_lut;  // TODO(dpwe): choose based on synth[osc]->preset.
}

// Structure of waveeditonlie wavetables.
//const int CYCLES_PER_WAVETABLE = 64;
const int WAVETABLE_SAMPLES_PER_CYCLE = 256;
const int WAVETABLE_LOG2_SAMPLES_PER_CYCLE = 8;

#ifdef GAMMA9001
#define PCM_WAVETABLE_BASE 19
#else
#define PCM_WAVETABLE_BASE 11
#endif

SAMPLE render_wavetable(SAMPLE* buf, uint16_t osc) {
    SAMPLE max_value = 0;
    float freq = freq_of_logfreq(msynth[osc]->logfreq);
    SAMPLE amp = F2S(msynth[osc]->amp);
    SAMPLE last_amp = F2S(msynth[osc]->last_amp);
    // LOCAL EDIT (S3-Amysynth, experimental): unison cluster.
    unison_copy copies[AMY_UNISON_MAX];
    uint8_t n = unison_prepare(osc, copies, freq, last_amp, amp);
    int16_t wavetable_preset = synth[osc]->preset;
    if (AMY_IS_UNSET(wavetable_preset))
        wavetable_preset = PCM_WAVETABLE_BASE;
    uint32_t sample_length;
    const int16_t *wavetable_samples = pcm_get_sample_ram_for_preset(wavetable_preset, &sample_length);
    if (wavetable_samples == NULL || sample_length < (2 * WAVETABLE_SAMPLES_PER_CYCLE)) {
        // We need at least two cycles to have something to crossfade.
        return 0;
    }
    int cycles_this_table = sample_length >> WAVETABLE_LOG2_SAMPLES_PER_CYCLE;
    // Don't try to interp beyond end of table.  An N-waveform table can be interpolated from 0 to (N-1-eps).
    float interp = MAX(0,
                       MIN(cycles_this_table - 1,
                           (cycles_this_table - 1) * msynth[osc]->duty));
    // always need both this wavetable and the next one.
    int cycle = MIN((int)floorf(interp),  // LOCAL EDIT: float, not double
                    cycles_this_table - 2);
    // fractional part, normally < 1.0, but == 1.0 for very end of table.
    interp = interp - cycle;
    LUT wavetable_lut = {
        wavetable_samples + cycle * WAVETABLE_SAMPLES_PER_CYCLE,
        WAVETABLE_SAMPLES_PER_CYCLE,
        WAVETABLE_LOG2_SAMPLES_PER_CYCLE,
        0,  /* highest harmonic, for choosing tables in set. */
        1.0f,  /* scale factor, for denormalizing. */
    };
    // don't update phase in the first call to render_lut, so second call uses the same phase
    SAMPLE interp_b = F2S(interp);
    SAMPLE interp_a = F2S(1.0f) - interp_b;
    // Point to next cycle.
    LUT next_lut = wavetable_lut;
    next_lut.table += WAVETABLE_SAMPLES_PER_CYCLE;
    // If we used last_duty, we could actually smoothly interpolate the waveshape crossfade too (except across table boundaries).
    for (uint8_t i = 0; i < n; ++i) {
        PHASOR *phase = unison_phase(osc, i);
        render_lut(buf, *phase, copies[i].step, SMULR7(copies[i].last_amp, interp_a), SMULR7(copies[i].amp, interp_a), &wavetable_lut, &max_value);
        *phase = render_lut(buf, *phase, copies[i].step, SMULR7(copies[i].last_amp, interp_b), SMULR7(copies[i].amp, interp_b), &next_lut, &max_value);
    }
    msynth[osc]->last_amp = msynth[osc]->amp;
    return max_value;
}
#endif
