## components/synth_core/Kconfig
```kconfig
menu "Sequencer Defaults"

config SYNTH_DEV_MENU
	bool "DEV menu (temporary/test controls)"
	default y
	help
		Adds a DEV entry at the top of the main menu hosting temporary
		test controls, runtime diagnostics and readouts (ui_screen_dev.c).
		Controls graduate to real screens if they prove out; disable for
		a clean end-user build - no DEV code is compiled in when off.

config SEQ_STATE_IN_PSRAM
	bool "Place sequencer layer tables in PSRAM"
	depends on SPIRAM
	default y
	help
		Allocate the sequencer core layer table (s_layers, ~7.5 KB) and the
		UI mirror state (seq_state, ~7.5 KB) from PSRAM at init instead of
		static internal DRAM, freeing ~15 KB of internal RAM. Accesses run
		through the data cache; the sequencer tick reads the layer table
		per block, so disable this if a render-path regression is ever
		traced here. Falls back to internal heap if the PSRAM allocation
		fails (and aborts at boot if both fail - this state is not
		optional). When disabled, both tables are static internal arrays
		exactly as before.

config SEQ_QUANTIZER_DEFAULT_ENABLED
	bool "Enable quantizer by default"
	default y
	help
		Initializes the melodic quantizer as enabled at boot.

config SEQ_QUANTIZER_DEFAULT_ROOT_NOTE
	int "Quantizer default root MIDI note"
	range 0 127
	default 60
	help
		Default quantizer root note at startup (60 = C4).

config SEQ_QUANTIZER_DEFAULT_SCALE
	int "Quantizer default scale index"
	range 0 8
	default 3
	help
		Default quantizer scale index at startup.
		0=Chromatic, 1=Major, 2=Natural Minor, 3=Dorian,
		4=Phrygian, 5=Lydian, 6=Mixolydian,
		7=Minor Pentatonic, 8=Major Pentatonic.

config SEQ_MELODIC_EXPRESSIVE_DEFAULTS
	bool "Enable expressive melodic defaults"
	default y
	help
		Enables melodic step velocity accents and a near-legato default gate
		(92% of a step) for new melodic layers. If disabled, melodic velocity
		defaults to 1.0 and new layers start at a 2/3-step gate.

choice SEQ_MELODIC_PATCH_PRESET
	prompt "Melodic layer AMY patch preset"
	default SEQ_MELODIC_PATCH_SINE
	help
		Selects which built-in AMY patch number the sequencer uses when
		creating melodic layers.

config SEQ_MELODIC_PATCH_JUNO_EPIANO1
	bool "Juno E PIANO 1 (patch 14)"

config SEQ_MELODIC_PATCH_JUNO_SYNTH_BASS2
	bool "JUNO SYNTH BASS 2 (patch 36)"

config SEQ_MELODIC_PATCH_JUNO_CHORUS_VIBES
	bool "JUNO CHORUS VIBES (patch 66)"

config SEQ_MELODIC_PATCH_JUNO_SYNTH_PAD
	bool "JUNO SYNTH PAD (patch 47)"

config SEQ_MELODIC_PATCH_JUNO_PIANO1
	bool "Juno A18 Piano I (patch 7)"

config SEQ_MELODIC_PATCH_JUNO_EPIANO_TREM
	bool "Juno B61 E. Piano with Tremolo (patch 104)"

config SEQ_MELODIC_PATCH_PIANO_BUILTIN
	bool "AMY built-in piano (patch 256)"

config SEQ_MELODIC_PATCH_SINE
	bool "Raw SINE waveform (patch 257)"

config SEQ_MELODIC_PATCH_CUSTOM_START
	bool "start of custom presets/raw waveforms"

endchoice

config SEQ_MELODIC_DISABLE_DEFAULT_LPF
	bool "Strip the patch-baked filter from fresh melodic voices"
	default n
	help
		Built-in AMY Juno/DX7 patch strings carry their own filter block
		(a G/F/R command trio -> filter_type/cutoff/resonance), so a freshly
		created melodic voice inherits that patch's low-pass filter before the
		user has authored anything in the filter editor.

		Enable this to push a FILTER_NONE event to every UNAUTHORED melodic
		row right after the patch loads, giving the raw, unfiltered patch tone.
		Rows the user has explicitly dialed in the filter editor
		(filter_authored) are never touched, so authored filters still win.

config SEQ_MELODIC_PATCH
	int
	default 14 if SEQ_MELODIC_PATCH_JUNO_EPIANO1
	default 36 if SEQ_MELODIC_PATCH_JUNO_SYNTH_BASS2
	default 66 if SEQ_MELODIC_PATCH_JUNO_CHORUS_VIBES
	default 47 if SEQ_MELODIC_PATCH_JUNO_SYNTH_PAD
	default 7 if SEQ_MELODIC_PATCH_JUNO_PIANO1
	default 104 if SEQ_MELODIC_PATCH_JUNO_EPIANO_TREM
	default 256 if SEQ_MELODIC_PATCH_PIANO_BUILTIN
	default 257 if SEQ_MELODIC_PATCH_SINE
	default 1 if SEQ_MELODIC_PATCH_CUSTOM_START
	help
		Resolved AMY patch number for melodic layer initialization.

config SEQ_MEL_VOICES
	int "Voices per melodic row"
	range 1 4
	default 1
	help
		One AMY synth is allocated PER ROW (per track). A row only ever
		sounds one pitch at a time, so a single voice suffices. Bump to 2
		to give note-off/note-on overlap headroom at the step boundary, at
		2x oscillator cost per row. Melodic rows take the melodic arena
		(SEQ_MEL_SLOT_COUNT slots, synth_slots.h), so higher values multiply
		oscillator use against AMY's 250-osc budget.

config SEQ_KS_VOICES_MAX
	int "KS voices per row, ceiling"
	range 1 4
	default 2
	help
		Upper bound for the DEV menu's KS voices-per-row value (KS page,
		runtime, default 2 or this ceiling if lower). A KS row plays
		that many voices whatever the layer's own voice count, chord rows
		included, so a note's tail can ring under the next one. Each KS
		voice's osc holds its own ring (~3.5 KB of PSRAM at 48 kHz) while it
		exists.

choice SEQ_PATCH_BROWSE_MODE
	prompt "Runtime melodic patch browse mode"
	default SEQ_PATCH_BROWSE_PRESELECTED
	help
		Controls what the runtime patch-select control (hold BPM button + turn
		encoder) cycles through.

config SEQ_PATCH_BROWSE_PRESELECTED
	bool "Preselected shortlist"
	help
		Cycle a curated shortlist: a few favourite Juno and DX7 patches, the
		built-in piano, the raw waves (257..263), the app's bass, wavetable,
		FM and additive voices, the app wavetable bank (280..287) and the
		custom wavetable (288). Fast to reach favourites; does not require
		the name table.

config SEQ_PATCH_BROWSE_FULL_RANGE
	bool "Full range (0..288)"
	help
		Cycle every patch number: Juno 0..127, DX7 128..255, the built-in
		piano (256), then the app's own voices up to the custom wavetable
		(288). Ranges whose feature is compiled out are skipped. Enable
		SEQ_PATCH_SHOW_NAMES to see what each is.

endchoice

config SEQ_PATCH_SHOW_NAMES
	bool "Show human-readable patch names"
	default y if SEQ_PATCH_BROWSE_FULL_RANGE
	default n
	help
		Compiles in a table of human-readable patch names (e.g. "DX7 E.Piano 1")
		and shows them on the OLED instead of the bare patch number. Costs flash
		(≈257 short strings + a pointer table). Disable to save flash — useful
		for preselected-only builds, or when browsing the full range under flash
		pressure (you then see just the patch number). The number is always
		shown; the name is appended only when this is enabled.

config SEQ_MELODIC_ENVELOPE_ENABLED
	bool "Apply melodic EG0 envelope defaults"
	default y
	help
		Sends a startup EG0 envelope configuration to melodic synth layers so
		note onsets and tails are shaped (soft attack, audible release) instead
		of being hard-gated. Disable to fall back to the raw patch envelope.

config SEQ_MELODIC_ENV_EG0_TYPE
	int "Melodic EG0 envelope type"
	range 0 3
	default 0
	help
		0=Normal, 1=Linear, 2=DX7-style, 3=True exponential.
		Use 0 (Normal) for a smooth, musical amplitude envelope. Type 2 (DX7)
		is meant for DX7-style level tables and sounds wrong when applied to a
		plain attack/decay/sustain/release breakpoint set.

config SEQ_MELODIC_ENV_ATTACK_MS
	int "Melodic envelope attack (ms)"
	range 0 5000
	default 4

config SEQ_MELODIC_ENV_DECAY_MS
	int "Melodic envelope decay (ms)"
	range 0 10000
	default 100

config SEQ_MELODIC_ENV_SUSTAIN_PCT
	int "Melodic envelope sustain level (%)"
	range 0 100
	default 60

config SEQ_MELODIC_ENV_RELEASE_MS
	int "Melodic envelope release (ms)"
	range 0 10000
	default 200

config SEQ_ADSR_EXPLICIT_DECAY
	bool "Explicit decay control in the ADSR editor (industry-norm)"
	default y
	help
		Controls how the DECAY time is handled in the ADSR editors
		(EG0 and EG1, across melodic/drone/arp targets).

		Enabled (default, industry norm): decay is a first-class control.
		The sustain point becomes draggable on BOTH axes - horizontal sets
		the decay TIME (in ms, read out on the top bar as "D ..ms") and
		vertical sets the sustain LEVEL. The encoder button cycles the
		sustain point between level and decay-time while adjusting. The
		stored per-voice decay_ms is shown and edited literally.

		Disabled: the legacy behaviour where decay TIME is derived, not
		dragged. The sustain point is level-only (Y) and its decay time is
		auto-computed from the attack time and sustain level
		(decay = clamp(120 + 0.5*attack + 400*(1-sustain), 20, 2000) ms).

		This is a compile-time behaviour switch; changing it requires a
		clean rebuild so the ADSR editor picks up the new mode.

config SEQ_ENV_DEBUG_DUMP
	bool "Log envelope events sent to AMY on commit"
	default n
	help
		Temporary verification aid. When enabled, committing an envelope in the
		ADSR editor logs the exact breakpoint event sent to the row's AMY synth
		(target synth, eg_type, attack/decay/release ms and sustain level), so
		you can confirm on hardware that edits reach the oscillators. Leave off
		for normal builds.

config SEQ_MELODIC_AMY_NATIVE_LFO
	bool "Use AMY built-in LFO for melodic wave patches"
	default y
	help
		When enabled, melodic tracks on raw waves, wavetables and bass
		presets drive the LFO through AMY's native modulation (every
		target, RANDOM as NOISE sample-and-hold). With SEQ_LFO_SHARED on,
		that is a shared LFO synth wired through mod slot 1 and the voices
		reserve no LFO oscs; with it off, each voice reserves a trailing
		carrier and wobble osc and the audible oscs name the carrier as
		mod_source. Patch strings (Juno, DX7, FM) use the shared LFO synths
		when SEQ_LFO_SHARED is on and the software stepper otherwise.
		Disable to put every wave-track LFO on the software stepper.

config SEQ_MEL_SLOT_COUNT
	int "Melodic synth slots (polyphony arena)"
	default 52
	range 8 200
	help
		AMY synth slots in the melodic sequencer's arena, above the static
		slots (arp, drones, drums, live voice, clip players). Each melodic
		row claims one slot. The real ceiling is AMY's osc pool (max_oscs);
		the slot map plus LFO_SYNTH_MAX must fit AMY's 8-bit synth number.

config SEQ_LFO_SHARED
	bool "Shared LFO synths (experimental)"
	default y
	help
		Every tempo-synced LFO runs as an osc in a small AMY synth of its
		own, shared by every voice that uses the same LFO settings and
		named through mod slot 1. Replaces the software stepper on patch
		strings and the per-voice carrier oscs on wave voices; the stepper
		remains the fallback when no shared LFO is free. Off keeps the
		per-voice native carriers and the stepper.

config LFO_SYNTH_MAX
	int "Shared LFO synths at once"
	default 32
	range 1 32
	depends on SEQ_LFO_SHARED
	help
		Most distinct LFO settings that can run as shared LFO synths at the
		same time, counting every voice's LFO1 and LFO2. Each one takes an
		AMY synth number above the slot map, one AMY voice and two oscs
		(carrier and wobble) while in use; an unused number costs a table
		entry. An LFO1 past this count falls back to the software stepper;
		an LFO2 past it does not run.

config SYNTH_CUSTOM_FM
	bool "Custom FM/DX7 6-operator voices (WIP)"
	default n
	help
		Compiles in the custom DX7-style 6-operator FM/ALGO melodic voices:
		the fixed FM presets (FM Bass/E.Piano/Bell/Lead), the live-editable
		FM Custom voice, plus the "Screen: FM" menu entry and its editor.

		Work in progress and off by default. When disabled, none of the FM
		voice code, presets, or editor screen is built; the FM patch numbers
		(272-276) are dropped from the runtime patch browser; and the FM menu
		entry is hidden.

config SYNTH_CUSTOM_WT
	bool "Custom wavetable builder"
	depends on AMY_WAVETABLE
	default y
	help
		Compiles in the Custom wavetable patch (288): a 64-frame table built
		on the device from sixteen parameters (Shape, Width, Bright, Sync and
		Peak for each of three keyframes, plus a harmonic Range cap), edited on the
		"Screen: WT" page and saved with the project. The table is rebuilt
		in slices on the UI task and costs 32 KB of PSRAM for the live table
		plus 64 KB for the build scratch.

		When disabled, the builder code and screen are not built, patch 288
		is dropped from the runtime patch browser, and the WT menu entry is
		hidden.

config SYNTH_CUSTOM_WT_TIMING
	bool "Log wavetable builder slice times"
	depends on SYNTH_CUSTOM_WT
	default n
	help
		Logs the time each rebuild slice takes (16 frames) and the finish
		step. Diagnostic only; leave off in normal builds.

config SYNTH_ADDITIVE
	bool "Additive/partials voices (WIP)"
	default n
	help
		Compiles in the additive-synthesis melodic voices built on AMY's
		BYO_PARTIALS wave type: the fixed presets (Add Organ, Add Bell) and
		the live-editable Add Custom voice. Each voice is one control osc
		plus up to 12 PARTIAL sine oscs, so it costs N+1 oscillators from
		the global pool per sounding voice.

		Work in progress and off by default. When disabled, none of the
		additive voice code or presets is built and the additive patch
		numbers (277-279) are dropped from the runtime patch browser.

comment "Arpeggiator"

config SEQ_ARP_DEFAULT_ENABLED
	bool "Arp enabled by default"
	default n
	help
		Whether the standalone arpeggiator runs at boot. It plays on its own
		AMY synth, in sync with the global tempo, alongside the sequencer.

config SEQ_ARP_DEFAULT_SCALE
	int "Arp default scale index"
	range 0 8
	default 0
	help
		The arp's own quantizer scale, used while the arp's quantize mode
		(Arp screen, or Arp Q on the Prog Gen page) is OWN.
		Note slots store raw chromatic notes and are snapped to this scale at
		playback. There is no on-device editor for it, so the default is
		Chromatic: OWN then means "no snapping", the useful opposite of GLOB
		and CHRD (CHRD follows the chord progression while it runs, and the
		global quantizer otherwise).
		0=Chromatic, 1=Major, 2=Natural Minor, 3=Dorian, 4=Phrygian,
		5=Lydian, 6=Mixolydian, 7=Minor Pentatonic, 8=Major Pentatonic.

config SEQ_ARP_DEFAULT_ROOT_NOTE
	int "Arp default root MIDI note"
	range 0 127
	default 40
	help
		The arp's own quantizer root note (60 = C4).

config SEQ_ARP_DEFAULT_GATE_PCT
	int "Arp default gate length (%)"
	range 10 100
	default 75
	help
		Fraction of each arp step the note is held before its note-off.

config SEQ_ARP_DEFAULT_OCTAVES
	int "Arp default octave span"
	range 1 4
	default 1
	help
		How many octaves the arp walks through before repeating.

config SEQ_ARP_DEFAULT_PATCH
	int "Arp default patch number"
	range 0 256
	default 138
	help
		AMY built-in patch for the arp synth (0..127 Juno, 128..255 DX7,
		256 built-in piano). 138 = DX7 E.Piano 1.

comment "Ball drop"

config SEQ_DROP_DEFAULT_ENABLED
	bool "Ball drop enabled by default"
	default n
	help
		Whether the ball drop engine runs at boot. Balls fall onto the
		segments of its field; every impact plays a note on the DROP synth
		and a jackpot crossing one on the SUB synth, as a loop that repeats
		in sync with the global tempo. The field itself boots empty, so an
		enabled drop is silent until segments are placed on its screen or
		a project supplies them.

config SEQ_DROP_DEFAULT_PATCH
	int "Ball drop default patch number (DROP synth)"
	range 0 266
	default 260
	help
		Patch for the impact synth (0..127 Juno, 128..255 DX7, 256 built-in
		piano, 257..263 raw waves, 264..266 bass presets). 260 = PULSE.

config SEQ_DROP_SUB_DEFAULT_PATCH
	int "Ball drop default patch number (SUB synth)"
	range 0 266
	default 257
	help
		Patch for the jackpot synth, full melodic catalog as the DROP synth
		(264..266 the multi-osc bass presets). 257 = SINE.

config SEQ_DROP_DEFAULT_ROOT_NOTE
	int "Ball drop default root MIDI note"
	range 0 127
	default 48
	help
		The pitch of the bottom field row; each row up is one scale degree.
		48 = C3. The SUB root boots one octave below it.


menu "Global FX Defaults"

config SEQ_FX_DEFAULT_ECHO
	int "Default echo level (0..100)"
	range 0 100
	default 0
	help
		Boot-time echo (delay) wet level, scaled to 0..1 before sending to
		AMY. 0 = off, 100 = full wet. Adjustable at runtime via the FX menu.

config SEQ_FX_DEFAULT_REVERB
	int "Default reverb level (0..100)"
	range 0 100
	default 0
	help
		Boot-time reverb wet level, scaled to 0..1 before sending to AMY.
		0 = off, 100 = full wet. Adjustable at runtime via the FX menu.

config SEQ_FX_DEFAULT_CHORUS
	int "Default chorus level (0..100)"
	range 0 100
	default 0
	help
		Boot-time chorus wet level, scaled to 0..1 before sending to AMY.
		0 = off, 100 = full wet. Adjustable at runtime via the FX menu.
		Applies to bus 0 (Bus 1 Main); split-off buses start at 0.
		Note: every AMY built-in Juno patch string overwrites the chorus of
		the bus it loads onto; synth_ui_fx_reassert() re-imposes this value
		after each patch load when "Preset FX" is off.

endmenu

config SYNTH_PROJECT_STORE
	bool "Persistent project storage (Projects menu)"
	default y
	help
		Save/load full session snapshots to the 'storage' LittleFS
		partition. Adds the Projects page to the main menu.

config SYNTH_PROJECT_MAX_SLOTS
	int "Project slots"
	depends on SYNTH_PROJECT_STORE
	range 1 64
	default 32

config SYNTH_PROJECT_SELFTEST
	bool "Project serializer boot self-test (diagnostic)"
	depends on SYNTH_PROJECT_STORE
	default n
	help
		Runs a serialize/parse round-trip at boot and logs PASS/FAIL.
		Diagnostic only - keep off in normal builds.

config SYNTH_DRUM_SYNTH_MODE
	bool "Synth (DX7/Juno) drum engine"
	default n
	help
		Compile the legacy Synth drum engine: a curated DX7/Juno patch
		list playable per drum track, selectable as the first entry of
		the Drum Bank menu item. When off, drum layers are PCM-only
		(808 ROM bank + gamma9001 sample banks) and projects saved with
		the Synth engine load as PCM.

config SEQ_OOM_RESYNC
	bool "Resync sequencer after AMY OOM bursts"
	default y
	help
		Poll AMY's OOM counter from the UI task; once a burst of
		allocation failures settles, re-emit every layer's scheduled
		steps and re-arm the arp. During an OOM window (e.g. an
		oversized patch load exhausting internal heap) scheduled
		events and tag cancels are dropped silently, leaving tracks
		mute until something re-emits them - this closes that window
		automatically. Disable to rule the hook out when debugging.

endmenu
```
