## components/priv_i2c_u8g2/Kconfig
```kconfig
menu "PRIV I2C U8G2 Component"

    config I2C_U8G2_I2C_PORT
        int "I2C Port Number"
        default 0
        help
            I2C controller index (for example 0 for I2C_NUM_0).

    config I2C_U8G2_SCL_GPIO
        int "SCL GPIO Number"
        default 5
        help
            GPIO number for I2C clock.

    config I2C_U8G2_SDA_GPIO
        int "SDA GPIO Number"
        default 4
        help
            GPIO number for I2C data.

    config I2C_U8G2_FREQ_HZ
        int "I2C Bus Frequency (Hz)"
        default 400000
        help
            I2C bus speed in Hertz.

    config I2C_U8G2_TIMEOUT_MS
        int "I2C Transaction Timeout (ms)"
        default 1000
        help
            Timeout used for display I2C transactions.

    config I2C_U8G2_DISPLAY_ADDRESS
        hex "Display I2C Address"
        range 0x00 0x7F
        default 0x3C
        help
            7-bit I2C address of the display device.

    config I2C_U8G2_INTERNAL_PULLUP
        bool "Enable internal SDA/SCL pull-ups"
        default y
        help
            Enable internal pull-up resistors for SDA/SCL pins.

endmenu
```

## components/sequencer_ui/Kconfig
```kconfig
menu "Sequencer Defaults"

config SEQ_QUANTIZER_DEFAULT_ENABLED
	bool "Enable quantizer by default"
	default y
	help
		Initializes the melodic quantizer as enabled at boot.

config SEQ_QUANTIZER_DEFAULT_ROOT_NOTE
	int "Quantizer default root MIDI note"
	range 0 127
	default 60
	help
		Default quantizer root note at startup (60 = C4).

config SEQ_QUANTIZER_DEFAULT_SCALE
	int "Quantizer default scale index"
	range 0 8
	default 0
	help
		Default quantizer scale index at startup.
		0=Chromatic, 1=Major, 2=Natural Minor, 3=Dorian,
		4=Phrygian, 5=Lydian, 6=Mixolydian,
		7=Minor Pentatonic, 8=Major Pentatonic.

config SEQ_MELODIC_EXPRESSIVE_DEFAULTS
	bool "Enable expressive melodic defaults"
	default y
	help
		Enables melodic step velocity accents and uses the configured melodic
		gate ratio. If disabled, melodic velocity defaults to 1.0 and the gate
		falls back to the original 2/3-step duration.

choice SEQ_MELODIC_PATCH_PRESET
	prompt "Melodic layer AMY patch preset"
	default SEQ_MELODIC_PATCH_DX7_EPIANO1
	help
		Selects which built-in AMY patch number the sequencer uses when
		creating melodic layers.

config SEQ_MELODIC_PATCH_DX7_EPIANO1
	bool "DX7 E.PIANO 1 (patch 138)"

config SEQ_MELODIC_PATCH_DX7_PIANO1
	bool "DX7 PIANO 1 (patch 135)"

config SEQ_MELODIC_PATCH_DX7_SYNLEAD1
	bool "DX7 SYN-LEAD 1 (patch 141)"

config SEQ_MELODIC_PATCH_DX7_FLUTE1
	bool "DX7 FLUTE 1 (patch 151)"

config SEQ_MELODIC_PATCH_JUNO_PIANO1
	bool "Juno A18 Piano I (patch 7)"

config SEQ_MELODIC_PATCH_JUNO_EPIANO_TREM
	bool "Juno B61 E. Piano with Tremolo (patch 104)"

config SEQ_MELODIC_PATCH_PIANO_BUILTIN
	bool "AMY built-in piano (patch 256)"

endchoice

config SEQ_MELODIC_PATCH
	int
	default 138 if SEQ_MELODIC_PATCH_DX7_EPIANO1
	default 135 if SEQ_MELODIC_PATCH_DX7_PIANO1
	default 141 if SEQ_MELODIC_PATCH_DX7_SYNLEAD1
	default 151 if SEQ_MELODIC_PATCH_DX7_FLUTE1
	default 7 if SEQ_MELODIC_PATCH_JUNO_PIANO1
	default 104 if SEQ_MELODIC_PATCH_JUNO_EPIANO_TREM
	default 256 if SEQ_MELODIC_PATCH_PIANO_BUILTIN
	help
		Resolved AMY patch number for melodic layer initialization.

config SEQ_MELODIC_GATE_NUMERATOR
	int "Melodic gate ratio numerator"
	range 1 12
	default 11
	help
		Numerator used to compute melodic note gate duration. A ratio close
		to 1 (e.g. 11/12) makes notes near-legato so they connect instead of
		stabbing; combined with the EG0 release this gives a sustained tail
		rather than the original short "car horn" staccato.

config SEQ_MELODIC_GATE_DENOMINATOR
	int "Melodic gate ratio denominator"
	range 1 12
	default 12
	help
		Denominator used to compute melodic note gate duration.

config SEQ_MELODIC_ENVELOPE_ENABLED
	bool "Apply melodic EG0 envelope defaults"
	default y
	help
		Sends a startup EG0 envelope configuration to melodic synth layers so
		note onsets and tails are shaped (soft attack, audible release) instead
		of being hard-gated. Disable to fall back to the raw patch envelope.

config SEQ_MELODIC_ENV_EG0_TYPE
	int "Melodic EG0 envelope type"
	range 0 3
	default 0
	help
		0=Normal, 1=Linear, 2=DX7-style, 3=True exponential.
		Use 0 (Normal) for a smooth, musical amplitude envelope. Type 2 (DX7)
		is meant for DX7-style level tables and sounds wrong when applied to a
		plain attack/decay/sustain/release breakpoint set.

config SEQ_MELODIC_ENV_ATTACK_MS
	int "Melodic envelope attack (ms)"
	range 0 5000
	default 10

config SEQ_MELODIC_ENV_DECAY_MS
	int "Melodic envelope decay (ms)"
	range 0 10000
	default 200

config SEQ_MELODIC_ENV_SUSTAIN_PCT
	int "Melodic envelope sustain level (%)"
	range 0 100
	default 60

config SEQ_MELODIC_ENV_RELEASE_MS
	int "Melodic envelope release (ms)"
	range 0 10000
	default 320

endmenu
```

## main/Kconfig.projbuild
```kconfig
menu "Audio Diagnostics"

config USB_AUDIO_DIAGNOSTICS
	bool "Enable USB audio diagnostics"
	default n
	help
		Compiles in USB audio diagnostic counters and periodic log snapshots.
		When enabled, the firmware tracks ring-buffer fill level, underrun events,
		overrun/drop events, and peak written sample magnitude.

endmenu

menu "USB Audio Behavior"

config USB_AUDIO_BLOCKING_WRITE
    bool "Block render task when USB buffer is full"
    default n
    help
        If enabled, the AMY render task will wait (retry with backoff) until 
        the USB ring buffer has space, effectively slave-clocking the synth
        to the PC's consumption rate. 
        If disabled (default), the task will drop overflowed blocks to 
        maintain real-time AMY clock alignment regardless of USB health,
        which can result in 'honky' percussive artifacts if transport is poor.

endmenu

menu "RTOS Diagnostics"

config AMYSYNTH_RTOS_STATS
    bool "Enable periodic RTOS runtime-stats diagnostic dump"
    default n
    help
        When enabled, app_main periodically prints the FreeRTOS task list,
        per-task CPU runtime %, per-core load, and per-task stack high-water
        marks via ESP_LOGI. Profiling aid; leave off for release builds.

config AMYSYNTH_RTOS_STATS_PERIOD_MS
    int "RTOS stats dump period (ms)"
    depends on AMYSYNTH_RTOS_STATS
    default 5000
    range 1000 60000
    help
        Interval between RTOS runtime-stats dumps emitted by app_main.

endmenu
```
